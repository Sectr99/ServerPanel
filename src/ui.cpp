#include "ui.h"
#include "config.h"
#include <algorithm>
#include <stdio.h>
#include <stdlib.h>
#include <string.h>
#include <ctype.h>
#include <utility>

#define DEGC "\xC2\xB0" "C"  // UTF-8 degree sign + C (the VLW fonts include U+00B0)
#define DEG "\xC2\xB0"

// ---------- palette (uint32_t = RGB888 in LovyanGFX) ----------
// The palette as it shows by day; night mode scales it by THEME_NIGHT / THEME_DAY (config.h), so the whole theme
// dims in software even if the backlight can't.
constexpr uint32_t BASE[] = {
    0x0F1419, 0x1A2129, 0x2A333D, 0x232B35,  // bg, card, track, grid: slate blue-gray
    0xE6EAF0, 0x9AA6B6, 0x66717F,            // text, muted, dim
    0x2FB1FF, 0x9A7BE6, 0x2394D6, 0x34D29A,  // cyan (series 1), violet, blue, green
    0xFFD050, 0xFF6A4A,                      // amber, red: status only, kept apart from the series colors
    0x2EDBA3, 0xFF7BAD, 0xE8A6FF};           // teal, pink (series 2), orchid: gradient tops
// Series 1/2 (cyan/pink), gradient tops and amber/red pass the dataviz palette checks (CVD, contrast) at THEME_DAY.
static uint32_t C_BG, C_CARD, C_TRACK, C_GRID, C_TEXT, C_MUTED, C_DIM, C_CYAN, C_VIOLET, C_BLUE, C_GREEN, C_AMBER, C_RED,
    C_TEAL, C_PINK, C_ORCHID;

static float palK = 1;  // the current palette scale: THEME_DAY or THEME_NIGHT
static void setPalette(float k) {
  palK = k;
  uint32_t* slots[] = {&C_BG, &C_CARD, &C_TRACK, &C_GRID, &C_TEXT, &C_MUTED, &C_DIM,
                       &C_CYAN, &C_VIOLET, &C_BLUE, &C_GREEN, &C_AMBER, &C_RED, &C_TEAL, &C_PINK, &C_ORCHID};
  for (int i = 0; i < 16; i++) {
    uint32_t c = BASE[i];
    auto ch = [&](int s) { return uint32_t(((c >> s) & 255) * k) << s; };
    *slots[i] = ch(16) | ch(8) | ch(0);
  }
}

// ---------- fonts: named roles ----------
// Bitmap fonts by default. With FONT_HEADER set (config.h: a family generated by tools/mkfonts.py), the roles
// switch to anti-aliased VLW versions of that family on first draw.
static const lgfx::IFont *F_SMALL = &fonts::DejaVu12, *F_BODY = &fonts::FreeSans9pt7b, *F_BODYB = &fonts::FreeSansBold9pt7b,
                         *F_STAT = &fonts::FreeSans12pt7b, *F_TITLE = &fonts::FreeSansBold12pt7b,
                         *F_BIG = &fonts::FreeSansBold18pt7b, *F_HUGE = &fonts::FreeSansBold24pt7b,
                         *F_CLOCK = &fonts::Orbitron_Light_24, *F_XL = &fonts::FreeSansBold24pt7b;
#ifdef FONT_HEADER
#include FONT_HEADER
static void initFonts() {
  static lgfx::PointerWrapper wrap[9];  // the fonts read glyph bitmaps through these on every draw: keep them alive
  static lgfx::VLWfont vlw[9];
  const struct { const uint8_t* data; size_t len; const lgfx::IFont** role; } f[9] = {
      {vlw_small, sizeof vlw_small, &F_SMALL}, {vlw_body, sizeof vlw_body, &F_BODY},
      {vlw_bodyb, sizeof vlw_bodyb, &F_BODYB}, {vlw_stat, sizeof vlw_stat, &F_STAT},
      {vlw_title, sizeof vlw_title, &F_TITLE}, {vlw_big, sizeof vlw_big, &F_BIG},
      {vlw_huge, sizeof vlw_huge, &F_HUGE},    {vlw_clock, sizeof vlw_clock, &F_CLOCK},
      {vlw_xl, sizeof vlw_xl, &F_XL}};
  for (int i = 0; i < 9; i++) {
    wrap[i].set(f[i].data, f[i].len);
    if (vlw[i].loadFont(&wrap[i])) *f[i].role = &vlw[i];  // keep the bitmap font if a VLW one fails to load
  }
}
#else
static void initFonts() {}
#endif

// Icons: Material Symbols drawn as text (ICON_* strings, tools/mkfonts.py icons): extra small (18 px: pills), small
// (28 px: status bar, tabs, rows), medium (40 px: Spotify, macro keys, launcher, weather) and large (80 px: placeholders).
#include "fonts/icons.h"
static const lgfx::IFont *I_XS = F_SMALL, *I_S = F_SMALL, *I_M = F_SMALL, *I_L = F_SMALL;
static void initIcons() {
  static lgfx::PointerWrapper wrap[4];
  static lgfx::VLWfont vlw[4];
  const struct { const uint8_t* data; size_t len; const lgfx::IFont** role; } f[4] = {
      {vlw_icon_xs, sizeof vlw_icon_xs, &I_XS}, {vlw_icon_s, sizeof vlw_icon_s, &I_S},
      {vlw_icon_m, sizeof vlw_icon_m, &I_M}, {vlw_icon_l, sizeof vlw_icon_l, &I_L}};
  for (int i = 0; i < 4; i++) {
    wrap[i].set(f[i].data, f[i].len);
    if (vlw[i].loadFont(&wrap[i])) *f[i].role = &vlw[i];
  }
}

static float clampf(float v, float lo, float hi) { return std::min(std::max(v, lo), hi); }

static bool fontsReady = false;
static void ensureFonts() {
  if (!fontsReady) { initFonts(); initIcons(); fontsReady = true; }
}

// ---------- fonts for what Inter lacks: Japanese, accents (tools/mkfonts.py sd, on the microSD card) ----------
// Each text role draws from its Inter font and falls back to its card font for anything else, on the Inter font's
// baseline. The card fonts' glyphs are read from their files as they're drawn, so they take next to no RAM.

// A font file read through stdio: the card is mounted at /sdcard on the panel; the preview reads a folder. A read that
// comes up short means the card has gone (pulled out, or failing): from then on every role draws from Inter alone
// (missing glyphs show as boxes) rather than waiting on the card for each glyph.
struct StdioFile : lgfx::DataWrapper {
  static inline bool failed = false;  // one flag for all: the files share the card
  FILE* fp = nullptr;
  bool open(const char* path) override { return (fp = fopen(path, "rb")) != nullptr; }
  int read(uint8_t* buf, uint32_t len) override {
    const size_t n = failed ? 0 : fread(buf, 1, len, fp);
    if (n < len) failed = true;
    return int(n);
  }
  void skip(int32_t offset) override { fseek(fp, offset, SEEK_CUR); }
  bool seek(uint32_t offset) override {
    if (!failed && fseek(fp, long(offset), SEEK_SET)) failed = true;
    return !failed;
  }
  void close() override { if (fp) fclose(fp); fp = nullptr; }
  int32_t tell() override { return int32_t(ftell(fp)); }
};

struct FallbackFont : lgfx::IFont {
  const lgfx::VLWfont *a = nullptr, *b = nullptr;
  const lgfx::VLWfont* pick(uint16_t c) const {
    uint16_t i;
    return c > 0x7E && !StdioFile::failed && !a->getUnicodeIndex(c, &i) && b->getUnicodeIndex(c, &i) ? b : a;
  }
  font_type_t getType() const override { return ft_vlw; }
  void getDefaultMetric(lgfx::FontMetrics* m) const override { a->getDefaultMetric(m); }
  bool updateFontMetric(lgfx::FontMetrics* m, uint16_t c) const override { return pick(c)->updateFontMetric(m, c); }
  size_t drawChar(lgfx::LGFXBase* g, int32_t x, int32_t y, uint16_t c, const lgfx::TextStyle* st, lgfx::FontMetrics* m,
                  int32_t& filled) const override {
    const lgfx::VLWfont* f = pick(c);
    if (f != a) y += int32_t((a->maxAscent - f->maxAscent) * st->size_y);  // onto the first font's baseline
    return f->drawChar(g, x, y, c, st, m, filled);
  }
};

int uiLoadExtraFonts(const char* dir) {
  ensureFonts();
  const struct { const char* name; const lgfx::IFont** role; } r[7] = {
      {"small", &F_SMALL}, {"body", &F_BODY}, {"bodyb", &F_BODYB}, {"stat", &F_STAT}, {"title", &F_TITLE},
      {"big", &F_BIG}, {"huge", &F_HUGE}};
  static StdioFile files[7];
  static lgfx::VLWfont extra[7];
  static FallbackFont wrap[7];
  int n = 0;
  for (int i = 0; i < 7; i++) {
    if ((*r[i].role)->getType() != lgfx::IFont::ft_vlw || wrap[i].b) continue;  // bitmap fonts, or already loaded
    char path[128];
    snprintf(path, sizeof path, "%s/%s.vlw", dir, r[i].name);
    if (!files[i].open(path)) continue;
    if (!extra[i].loadFont(&files[i])) {  // a damaged file: skip it, without giving up on the rest
      files[i].close();
      StdioFile::failed = false;
      continue;
    }
    wrap[i].a = static_cast<const lgfx::VLWfont*>(*r[i].role);
    wrap[i].b = &extra[i];
    *r[i].role = &wrap[i];
    n++;
  }
  return n;
}

// ---------- history ----------
// Each graph point is the mean of every reading taken during its slot, not one instant reading.
struct Hist {
  float v[HIST_N]; int head = 0, count = 0;
  double sum = 0; int n = 0;
  void add(float x) { if (!isnan(x)) { sum += x; n++; } }
  void commit() { push(n ? float(sum / n) : NAN); sum = 0; n = 0; }
  void push(float x) { v[head] = x; head = (head + 1) % HIST_N; if (count < HIST_N) count++; }
  float at(int i) const { return v[(head - count + i + HIST_N) % HIST_N]; }  // 0 = oldest
  float max() const { float m = 0; for (int i = 0; i < count; i++) if (at(i) > m) m = at(i); return m; }
};
static Hist hPcCpu, hPcGpu, hPcCpuT, hPcGpuT, hPcRam, hNasCpu, hNasCpuT, hNasGpu, hNasGpuT, hNasRam, hRx, hTx, hPrNoz, hPrBed;
#define ALL_HIST &hPcCpu, &hPcGpu, &hPcCpuT, &hPcGpuT, &hPcRam, &hNasCpu, &hNasCpuT, &hNasGpu, &hNasGpuT, &hNasRam, &hRx, &hTx, \
                 &hPrNoz, &hPrBed

// Per-disk (a = temp, b = used %) and per-container (a = CPU %, b = memory MB) history, keyed by name
// because those lists can reorder or change between polls.
struct Named { char name[28]; Hist a, b; };
static Named diskH[MAX_DISKS], ctrH[MAX_CTR];
static Named* named(Named* pool, int n, const char* name, bool create) {
  for (int i = 0; i < n; i++) if (!strcmp(pool[i].name, name)) return &pool[i];
  if (create)
    for (int i = 0; i < n; i++)
      if (!pool[i].name[0]) { snprintf(pool[i].name, sizeof pool[i].name, "%s", name); return &pool[i]; }
  return nullptr;
}

void uiSample(const Data& d, const Status& s, bool commit) {
  hPcCpu.add(s.pc ? d.pcCpu : NAN);    hPcGpu.add(s.pc ? d.pcGpu : NAN);
  hPcCpuT.add(s.pc ? d.pcCpuT : NAN);  hPcGpuT.add(s.pc ? d.pcGpuT : NAN);
  hPcRam.add(s.pc ? d.pcRam : NAN);
  hNasCpu.add(s.nas ? d.nasCpu : NAN); hNasCpuT.add(s.nas ? d.nasCpuT : NAN); hNasRam.add(s.nas ? d.nasRam : NAN);
  hNasGpu.add(s.nas ? d.nasGpu : NAN); hNasGpuT.add(s.nas ? d.nasGpuT : NAN);
  hRx.add(s.nas ? d.nasRx : NAN);      hTx.add(s.nas ? d.nasTx : NAN);
  hPrNoz.add(s.printer ? d.pr.noz : NAN); hPrBed.add(s.printer ? d.pr.bed : NAN);
  for (int i = 0; s.unraid && i < d.nDisks; i++)
    if (Named* h = named(diskH, MAX_DISKS, d.disks[i].name, true)) {
      h->a.add(d.disks[i].temp > 0 ? d.disks[i].temp : NAN);  // asleep = gap
      h->b.add(d.disks[i].pct);
    }
  for (int i = 0; s.docker && i < d.nCtr; i++)
    if (Named* h = named(ctrH, MAX_CTR, d.ctr[i].name, true)) {
      bool up = strcmp(d.ctr[i].status, "exited") && strcmp(d.ctr[i].status, "created");
      h->a.add(up ? d.ctr[i].cpu : NAN);
      h->b.add(up ? d.ctr[i].memMB : NAN);
    }
  if (!commit) return;
  for (Hist* h : {ALL_HIST}) h->commit();
  for (int i = 0; i < MAX_DISKS; i++) if (diskH[i].name[0]) { diskH[i].a.commit(); diskH[i].b.commit(); }
  for (int i = 0; i < MAX_CTR; i++) if (ctrH[i].name[0]) { ctrH[i].a.commit(); ctrH[i].b.commit(); }
}

// Graph window change: old points were spaced differently, so start the graphs over.
static void clearHistory() {
  for (Hist* h : {ALL_HIST}) *h = Hist();
  for (Named& n : diskH) { n.a = Hist(); n.b = Hist(); }
  for (Named& n : ctrH) { n.a = Hist(); n.b = Hist(); }
}

// ---------- navigation state + tap targets ----------
// Every tappable thing registers its rectangle while it is drawn; uiTap() matches against the last frame.
enum Act : uint8_t { ACT_PAGE, ACT_GAUGE, ACT_DISK, ACT_CTR, ACT_SETTINGS, ACT_SET, ACT_APP, ACT_MACRO, ACT_DECK, ACT_CAM,
                    ACT_RADAR,    // an op on the radar screen or its location sheet (RadarOp)
                    ACT_SPOTIFY };  // a Spotify control (SpotifyCmd); seek and volume read the tap's x
enum GaugeId : uint8_t { G_PC_CPU, G_PC_CPUT, G_PC_GPU, G_PC_GPUT, G_PC_RAM, G_NAS_CPU, G_NAS_CPUT, G_NAS_RAM, G_NAS_GPU, G_NAS_GPUT,
                        G_PR_NOZ, G_PR_BED,
                        G_ARRAY };  // also indexes the detail table in drawDetail; ARRAY opens the storage page instead
struct Hit { int16_t x, y, w, h; Act act; uint8_t arg; char name[28]; };
static Hit hits[48];
static int nHits = 0;
static void hit(int x, int y, int w, int h, Act act, uint8_t arg, const char* name = "") {
  if (nHits == 48) return;
  Hit& t = hits[nHits++];
  t.x = x; t.y = y; t.w = w; t.h = h; t.act = act; t.arg = arg;
  snprintf(t.name, sizeof t.name, "%s", name);
}

enum Detail : uint8_t { DET_NONE, DET_GAUGE, DET_DISK, DET_CTR, DET_SETTINGS, DET_CAMERA };
static Page page = PAGE_PC;
static Detail detail = DET_NONE;
static bool home = false;  // launcher showing; the apps keep their state underneath
static uint8_t app = FN_STATS;  // an app's Function: any but FN_LAUNCHER
static bool dropOpen = false;   // settings: Function dropdown list showing
static bool radarSheet = false; // weather radar: the location sheet is open
static bool spVolume = false;   // spotify: the control strip shows the volume slider instead of the buttons
static uint8_t spSheet = 0;     // spotify: 0 the player, or the library or devices sheet (SPU_LIBRARY, SPU_DEVICES)
static int8_t radarAlert = -1;  // weather radar: the alert sheet shows this alert; -1 = closed
static int8_t macroTapped = -1, macroFlash = -1;  // flash: key drawn highlighted for one frame
const Macro MACROS[] = MACRO_KEYS;
const int N_MACROS = sizeof MACROS / sizeof MACROS[0];
static uint8_t detailGauge = 0;
static char detailName[28] = "";

void uiShowPage(Page p) {  // PAGE_COUNT = launcher
  home = p >= PAGE_COUNT;
  if (!home) { page = p; app = FN_STATS; }
  detail = DET_NONE;
}
void uiShowLauncher() { home = true; detail = DET_NONE; }
static void openFunction() {  // switch to the Function's app (or the launcher), leaving any detail view as is
  home = settings.function == FN_LAUNCHER;
  if (!home) app = settings.function;
}
void uiHome() { detail = DET_NONE; page = Page(settings.startPage); openFunction(); }
int uiTakeMacro() { int m = macroTapped; macroTapped = -1; return m; }
static int8_t deckTapped = -1, deckFlash = -1;
int uiTakeDeckPress() { int k = deckTapped; deckTapped = -1; return k; }
void uiNextPage() { if (detail == DET_NONE && !home && app == FN_STATS) page = Page((page + 1) % PAGE_COUNT); }

void uiSwipe(int dir) {  // +1 = next page, -1 = previous; in a detail view any swipe just closes it
  if (detail != DET_NONE) { detail = DET_NONE; return; }
  if (!home && app == FN_SPOTIFY && spSheet) { spSheet = 0; return; }  // a swipe closes the library or devices sheet
  if (!home && app == FN_RADAR && (radarSheet || radarAlert >= 0)) {  // a swipe closes the location or alert sheet
    radarSheet = false;
    radarAlert = -1;
    return;
  }
  if (home || app != FN_STATS) return;  // only server stats has pages
  page = Page((page + PAGE_COUNT + dir) % PAGE_COUNT);
}

static void applyOp(uint8_t op);
static bool isDropOption(uint8_t op);  // an entry in the open Function list
static void radarOp(uint8_t op);       // a tap on the radar screen or its location sheet
static void spotifyOp(uint8_t cmd, float at);  // a Spotify control; at = where across it the tap landed, 0-1

void uiTap(int x, int y) {
  if (detail == DET_SETTINGS) {  // settings only react to their controls; with the dropdown open, only to its list
    for (int i = nHits - 1; i >= 0; i--) {
      const Hit& t = hits[i];
      if (t.act != ACT_SET || x < t.x || y < t.y || x >= t.x + t.w || y >= t.y + t.h) continue;
      if (!dropOpen || isDropOption(t.arg)) applyOp(t.arg);
      else dropOpen = false;
      return;
    }
    dropOpen = false;
    return;
  }
  if (detail != DET_NONE) { detail = DET_NONE; return; }  // any tap closes a detail view
  for (int i = nHits - 1; i >= 0; i--) {
    const Hit& t = hits[i];
    if (x < t.x || y < t.y || x >= t.x + t.w || y >= t.y + t.h) continue;
    switch (t.act) {
      case ACT_PAGE: page = Page(t.arg); return;
      case ACT_GAUGE:
        if (t.arg == G_ARRAY) { page = PAGE_STORAGE; return; }  // the array has its own page
        detail = DET_GAUGE; detailGauge = t.arg; return;
      case ACT_DISK: detail = DET_DISK; snprintf(detailName, sizeof detailName, "%s", t.name); return;
      case ACT_CTR: detail = DET_CTR; snprintf(detailName, sizeof detailName, "%s", t.name); return;
      case ACT_SETTINGS: detail = DET_SETTINGS; dropOpen = false; return;
      case ACT_SET: return;
      case ACT_APP:  // an app opens on its main screen, not on a sheet left open last time
        home = false;
        app = t.arg;
        radarSheet = false;
        radarAlert = -1;
        spSheet = 0;
        spVolume = false;
        return;
      case ACT_MACRO: macroTapped = macroFlash = t.arg; return;
      case ACT_DECK: deckTapped = deckFlash = t.arg; return;
      case ACT_CAM: detail = DET_CAMERA; return;
      case ACT_RADAR: radarOp(t.arg); return;
      case ACT_SPOTIFY: spotifyOp(t.arg, clampf((x - t.x - 12) / float(t.w - 24), 0, 1)); return;  // 12: the hit's padding
    }
  }
  // A tap on nothing does nothing: pages change by swiping.
}

bool uiDrag(int x0, int y0, int x1) {
  if (detail != DET_NONE) return false;
  for (int i = nHits - 1; i >= 0; i--) {
    const Hit& t = hits[i];
    if (t.act != ACT_SPOTIFY || (t.arg != SP_SEEK && t.arg != SP_VOLUME)) continue;
    if (x0 < t.x || y0 < t.y || x0 >= t.x + t.w || y0 >= t.y + t.h) continue;
    spotifyOp(t.arg, clampf((x1 - t.x - 12) / float(t.w - 24), 0, 1));  // 12: the hit's padding, as in uiTap
    return true;
  }
  return false;
}

// ---------- drawing helpers ----------
static uint32_t mix(uint32_t a, uint32_t b, float t) {  // t=1 -> a
  auto ch = [&](int s) { return uint32_t(((a >> s) & 255) * t + ((b >> s) & 255) * (1 - t)) << s; };
  return ch(16) | ch(8) | ch(0);
}
static uint32_t sev(float v, float warn, float crit, uint32_t base) {
  return v >= crit ? C_RED : v >= warn ? C_AMBER : base;
}
static void text(int x, int y, const char* s, const lgfx::IFont* f, uint32_t col, textdatum_t d = top_left) {
  spr.setFont(f);
  spr.setTextColor(col);
  spr.setTextDatum(d);
  spr.drawString(s, x, y);
}
static void dot(int x, int y, uint32_t col) { spr.fillSmoothCircle(x, y, 4, col); }

// Draws s, cut short with "..." to fit w pixels.
static void textFit(int x, int y, const char* s, int w, const lgfx::IFont* f, uint32_t col,
                    textdatum_t d = top_left) {
  char buf[160];
  snprintf(buf, sizeof buf, "%s", s);
  spr.setFont(f);
  if (spr.textWidth(buf) > w)  // drop whole characters (UTF-8: a lead byte and its continuation bytes) until it fits
    for (size_t n = strlen(buf); n > 0;) {
      do n--; while (n > 0 && (buf[n] & 0xC0) == 0x80);
      strcpy(buf + n, "...");
      if (spr.textWidth(buf) <= w) break;
    }
  text(x, y, buf, f, col, d);
}

// Sample i of `count` (0 = oldest) spans [xa, xb) when HIST_N samples are stretched across w pixels.
struct XScale {
  int x, w, count; float px;
  XScale(int x, int w, int count) : x(x), w(w), count(count), px(w / float(HIST_N)) {}
  int xa(int i) const { return x + w - int(lroundf((count - i) * px)); }
  int xb(int i) const { return x + w - int(lroundf((count - i - 1) * px)); }
  float xc(int i) const { return x + w - (count - i - 0.5f) * px; }
};

// Y range that fits the window's data with 10% headroom, at least a fifth of [lo, hi] tall (so idle jitter isn't
// blown up into big waves), rounded out to multiples of 5 so it only moves when the data really does.
static std::pair<float, float> fitRange(const Hist& a, float lo, float hi) {
  float mn = NAN, mx = NAN;
  for (int i = 0; i < a.count; i++)
    if (!isnan(a.at(i))) { mn = isnan(mn) ? a.at(i) : fminf(mn, a.at(i)); mx = isnan(mx) ? a.at(i) : fmaxf(mx, a.at(i)); }
  if (isnan(mn)) return {lo, hi};
  float pad = fmaxf((mx - mn) * 0.1f, 1), b0 = mn - pad, b1 = mx + pad, span = (hi - lo) / 5;
  if (b1 - b0 < span) { float c = (b0 + b1) / 2; b0 = c - span / 2; b1 = c + span / 2; }
  b0 = floorf(b0 / 5) * 5; b1 = ceilf(b1 / 5) * 5;
  if (b0 < lo) { b1 += lo - b0; b0 = lo; }
  if (b1 > hi) { b0 = fmaxf(lo, b0 - (b1 - hi)); b1 = hi; }
  return {b0, b1};
}

// A colour (RGB888) nudged by a 4 x 4 Bayer pattern below the bits RGB565 drops, for gradients: a plain fade shows
// visible bands on the panel.
static uint32_t dither(uint32_t c, int x, int y) {
  static const uint8_t bayer[16] = {0, 8, 2, 10, 12, 4, 14, 6, 3, 11, 1, 9, 15, 7, 13, 5};
  const float d = (bayer[(y & 3) * 4 + (x & 3)] + 0.5f) / 16;
  auto ch = [&](int sh, int step) { return uint32_t(std::min(255, int((c >> sh) & 255) + int(d * step))); };
  return ch(16, 8) << 16 | ch(8, 4) << 8 | ch(0, 8);
}

// An area chart of one history, newest at the right: a smoothed 2.5 px line over a fill that fades toward the
// bottom, and a dot on the latest point. zoom: the y axis fits the data (fitRange within [lo, hi]); otherwise [lo, hi]
// as given. sqrtY: a square-root axis, so normal traffic stays visible after a big burst. Gaps stay gaps. under: the
// colour behind it. Returns the y range used.
static std::pair<float, float> chart(int x, int y, int w, int h, const Hist& a, uint32_t col, float lo, float hi,
                                     bool zoom = true, bool sqrtY = false, uint32_t under = 0) {
  if (!under) under = C_CARD;
  auto [vlo, vhi] = zoom ? fitRange(a, lo, hi) : std::pair{lo, hi};
  static float sm[HIST_N];  // display-only smoothing: centred 9-point mean; the stored history is untouched
  for (int i = 0; i < a.count; i++) {
    float sum = 0; int n = 0;
    if (!isnan(a.at(i)))
      for (int j = std::max(0, i - 4); j <= std::min(a.count - 1, i + 4); j++)
        if (!isnan(a.at(j))) { sum += a.at(j); n++; }
    sm[i] = n ? sum / n : NAN;
  }
  auto py = [&](float v) {
    float f = clampf((v - vlo) / (vhi - vlo), 0, 1);
    return y + h - 3 - (sqrtY ? sqrtf(f) : f) * (h - 6);
  };
  const uint32_t top = mix(col, under, 0.30f), bot = mix(col, under, 0.02f);
  XScale sx(x, w, a.count);
  for (int i = 0; i < a.count; i++) {
    if (isnan(sm[i])) continue;
    int yv = py(sm[i]);
    for (int gx = sx.xa(i); gx < sx.xb(i); gx++)
      for (int yy = yv; yy < y + h; yy++) spr.drawPixel(gx, yy, dither(mix(top, bot, 1 - float(yy - y) / h), gx, yy));
  }
  for (int i = 1; i < a.count; i++)
    if (!isnan(sm[i - 1]) && !isnan(sm[i])) spr.drawWideLine(sx.xc(i - 1), py(sm[i - 1]), sx.xc(i), py(sm[i]), 1.25f, col);
  if (a.count && !isnan(sm[a.count - 1])) {
    int ey = py(sm[a.count - 1]);
    spr.fillSmoothCircle(x + w - 5, ey, 7, under);
    spr.fillSmoothCircle(x + w - 5, ey, 5, col);
  }
  return {vlo, vhi};
}

static void fmtRate(char* buf, size_t n, float bps) {
  if (isnan(bps)) snprintf(buf, n, "--");
  else if (bps >= 1e9f) snprintf(buf, n, "%.2f Gb/s", bps / 1e9f);
  else if (bps >= 1e8f) snprintf(buf, n, "%.0f Mb/s", bps / 1e6f);  // 682 Mb/s, not 682.0
  else if (bps >= 1e6f) snprintf(buf, n, "%.1f Mb/s", bps / 1e6f);
  else snprintf(buf, n, "%.0f kb/s", bps / 1e3f);
}

static void fmtMem(char* buf, size_t n, float mb) {
  if (mb >= 1024) snprintf(buf, n, "%.1f GB", mb / 1024);
  else snprintf(buf, n, "%.0f MB", mb);
}

static uint32_t statusColor(const char* st) {
  if (!strcmp(st, "healthy") || !strcmp(st, "running")) return C_GREEN;
  if (!strcmp(st, "unhealthy") || !strcmp(st, "dead")) return C_RED;
  if (!strcmp(st, "starting") || !strcmp(st, "restarting") || !strcmp(st, "paused")) return C_AMBER;
  return C_DIM;  // exited, created: stopped on purpose more often than not
}

// ---------- layout ----------
// Every screen but Spotify and the full-screen camera has a 56 px status bar; Server Stats adds a 64 px tab strip
// along the bottom. Cards sit on a 16 px margin and gap.
constexpr int M = 16, GAP = 16, SB_H = 56, TOP = 64, BOTTOM = H - 16, BODY_W = W - 2 * M;
constexpr int TAB_H = 64, TAB_Y = H - TAB_H, STATS_BOTTOM = TAB_Y - 12;

static void card(int x, int y, int w, int h) { spr.fillSmoothRoundRect(x, y, w, h, 20, C_CARD); }
static uint32_t field() { return mix(C_TRACK, C_CARD, 0.55f); }  // controls on a card: steppers, segments, chips

// Background: the screen's accent faintly at the top, fading into the base colour by 60% of the height. bgAt gives
// the colour behind any row, for rounding corners over it.
static bool sizeSprite(LGFX_Sprite& s, int w, int h);

// A full-screen vertical gradient from c0 at the top to c1 at `span` of the height, dithered, and kept in `cache`
// until its colours change: dithering every pixel takes a moment, copying the cache doesn't.
struct Gradient { LGFX_Sprite sprite; uint32_t c0 = 1, c1 = 1; float span = 0; };
static void gradient(Gradient& g, uint32_t c0, uint32_t c1, float span) {
  auto at = [&](int y) { return mix(c1, c0, clampf(y / (H * span), 0, 1)); };
  if (g.c0 != c0 || g.c1 != c1 || g.span != span || g.sprite.width() != W) {
    if (!sizeSprite(g.sprite, W, H)) {  // no room for the cache: plain rows
      for (int y = 0; y < H; y++) spr.drawFastHLine(0, y, W, at(y));
      return;
    }
    for (int y = 0; y < H; y++) {
      const uint32_t c = at(y);
      for (int x = 0; x < W; x++) g.sprite.drawPixel(x, y, dither(c, x, y));
    }
    g.c0 = c0; g.c1 = c1; g.span = span;
  }
  g.sprite.pushSprite(&spr, 0, 0);
}

static uint32_t bgTop = 0;
static uint32_t bgAt(int y) { return mix(C_BG, bgTop, clampf(y / (H * 0.6f), 0, 1)); }
static void background(uint32_t accent, float strength = 0.10f) {
  static Gradient g;
  bgTop = mix(accent, C_BG, strength);
  gradient(g, bgTop, C_BG, 0.6f);
}

// A solid rounded badge, dark text on its colour (a disk temperature, "latest"); rx = its right edge.
static int pill(int rx, int cy, const char* s, uint32_t col) {
  spr.setFont(F_SMALL);
  int w = spr.textWidth(s) + 20;
  spr.fillSmoothRoundRect(rx - w, cy - 12, w, 24, 12, col);
  text(rx - w / 2, cy, s, F_SMALL, C_BG, middle_center);
  return w;
}

// A dark floating chip with a status dot (over a picture or the map): "LIVE", "Not live". rx = its right edge.
static void chip(int rx, int cy, const char* s, uint32_t dotCol) {
  spr.setFont(F_SMALL);
  int w = spr.textWidth(s) + 40;
  spr.fillSmoothRoundRect(rx - w, cy - 14, w, 28, 14, C_BG);
  dot(rx - w + 16, cy, dotCol);
  text(rx - w + 28, cy, s, F_SMALL, C_TEXT, middle_left);
}

static void gear(int cx, int cy, uint32_t c) { text(cx, cy, ICON_SETTINGS_FILL, I_S, c, middle_center); }

// "9:47" + "PM" in 12-hour mode (returns the suffix), "21:47" + nullptr in 24-hour mode.
static const char* fmtClock(char* buf, size_t n, const tm* t) {
  if (settings.clock24) { snprintf(buf, n, "%02d:%02d", t->tm_hour, t->tm_min); return nullptr; }
  snprintf(buf, n, "%d:%02d", (t->tm_hour + 11) % 12 + 1, t->tm_min);  // no leading zero
  return t->tm_hour < 12 ? "AM" : "PM";
}

// Status bar text for an offline source, with how long ago it last answered: pc, nas, unraid, docker, printer. Set by
// uiDraw.
static char offTxt[5][48];

// The status bar, 56 px: the app's icon (or a back arrow) and title, then a subtitle after an optional dot; date and
// clock at the right, and the settings gear at the far right when `gear`. Offline, the subtitle becomes `offline`
// after a red dot; without Wi-Fi, "Wi-Fi connecting..." after an amber one. back: the left 260 px is a back button.
static void statusBar(const tm* t, bool wifi, const char* icon, uint32_t accent, const char* title, const char* sub,
                      uint32_t subDot = 0, bool online = true, const char* offline = "OFFLINE", bool back = false,
                      bool withGear = false) {
  int rx = W - 20;
  if (withGear) {
    gear(rx - 14, SB_H / 2, C_MUTED);
    hit(rx - 40, 0, 60, SB_H, ACT_SETTINGS, 0);
    rx -= 50;
  }
  if (t) {
    char buf[32];
    if (const char* ampm = fmtClock(buf, sizeof buf, t)) {
      text(rx, 38, ampm, F_SMALL, C_MUTED, baseline_right);
      rx -= spr.textWidth(ampm) + 5;
    }
    text(rx, 38, buf, F_CLOCK, C_TEXT, baseline_right);
    rx -= spr.textWidth(buf) + 18;
    strftime(buf, sizeof buf, "%a %b %d", t);
    text(rx, 38, buf, F_BODY, C_MUTED, baseline_right);
    rx -= spr.textWidth(buf) + 24;
  }
  int x = 20;
  if (back) {
    text(x + 12, SB_H / 2, ICON_ARROW_BACK_IOS_NEW, I_S, C_TEXT, middle_center);
    hit(0, 0, 260, SB_H, ACT_SET, 0 /* OP_BACK */);
  } else {
    text(x + 14, SB_H / 2, icon, I_S, accent, middle_center);
  }
  x += 40;
  textFit(x, SB_H / 2, title, rx - x, F_TITLE, C_TEXT, middle_left);
  x += spr.textWidth(title) + 14;
  const char* s = !wifi ? "Wi-Fi connecting..." : online ? sub : offline;
  const uint32_t dc = !wifi ? C_AMBER : online ? subDot : C_RED;
  if (!s || !*s || rx - x < 60) return;
  if (dc) { dot(x + 4, SB_H / 2, dc); x += 16; }
  textFit(x, SB_H / 2, s, rx - x, F_BODY, online && wifi ? C_MUTED : C_TEXT, middle_left);
}

// Server Stats' tab strip: a tab per page, the current one in the accent with a bar along its top.
static void tabStrip(Page pg) {
  static const struct { const char* icon; const char* label; } tabs[PAGE_COUNT] = {
      {ICON_DESKTOP_WINDOWS_FILL, "Desktop"}, {ICON_DNS_FILL, "NAS"}, {ICON_HARD_DRIVE_FILL, "Storage"},
      {ICON_DEPLOYED_CODE_FILL, "Docker"}, {ICON_PRINT_FILL, "Printer"}};
  spr.fillRect(0, TAB_Y, W, TAB_H, mix(C_BG, 0x000000, 0.65f));
  for (int i = 0; i < PAGE_COUNT; i++) {
    const int x0 = W * i / PAGE_COUNT, tw = W / PAGE_COUNT;
    const uint32_t c = i == pg ? C_CYAN : mix(C_MUTED, C_DIM, 0.5f);
    if (i == pg) spr.fillRect(x0, TAB_Y, tw, 3, C_CYAN);
    spr.setFont(F_BODYB);
    const int lw = spr.textWidth(tabs[i].label), sx = x0 + (tw - 38 - lw) / 2;
    text(sx + 14, TAB_Y + TAB_H / 2 + 1, tabs[i].icon, I_S, c, middle_center);
    text(sx + 38, TAB_Y + TAB_H / 2 + 1, tabs[i].label, F_BODYB, c, middle_left);
    hit(x0, TAB_Y, tw, TAB_H, ACT_PAGE, i);
  }
}

// A value for a hero card: number and unit apart, a caption, and the dot beside the caption (severity, or the series'
// colour). id: the detail view a tap opens; 255 = none.
struct Val { char num[12]; const char* unit; const char* caption; uint32_t dot; uint8_t id; };
static Val val(float v, const char* unit, const char* caption, uint32_t dotCol, uint8_t id) {
  Val r{{}, unit, caption, dotCol, id};
  if (isnan(v)) snprintf(r.num, sizeof r.num, "--");
  else snprintf(r.num, sizeof r.num, "%.0f", v);
  return r;
}
struct Lane { const Hist* h; uint32_t col; float lo, hi; bool zoom, sqrtY; };

// A hero card: icon, name and a note at the top; two values at 50 px; a lane for each below (the first taller).
// Each value and its lane open that value's detail view.
static void heroCard(int x, int y, int w, int h, const char* icon, uint32_t col, const char* name, const char* note,
                     const Val& a, const Val& b, const Lane& la, const Lane& lb) {
  card(x, y, w, h);
  text(x + 36, y + 34, icon, I_S, col, middle_center);
  text(x + 60, y + 34, name, F_TITLE, C_TEXT, middle_left);
  if (note) text(x + w - 22, y + 34, note, F_BODY, C_MUTED, middle_right);
  auto width = [&](const Val* v, const lgfx::IFont* nf, const lgfx::IFont* uf) {
    spr.setFont(nf);
    int nw = int(spr.textWidth(v->num));
    spr.setFont(uf);
    return strcmp(v->num, "--") ? nw + int(spr.textWidth(v->unit)) + 4 : nw;
  };
  const bool fit = 22 + std::max(width(&a, F_HUGE, F_TITLE) + 40, 150) + width(&b, F_HUGE, F_TITLE) <= w - 22;
  const lgfx::IFont *nf = fit ? F_HUGE : F_BIG, *uf = fit ? F_TITLE : F_BODY;
  int vx = x + 22;
  for (const Val* v : {&a, &b}) {
    const bool none = !strcmp(v->num, "--");
    text(vx, y + 64 + (fit ? 0 : 10), v->num, nf, none ? C_DIM : C_TEXT);
    int nw = spr.textWidth(v->num);
    if (!none) text(vx + nw + 4, y + 64 + (fit ? 14 : 22), v->unit, uf, C_MUTED);
    nw = width(v, nf, uf);
    dot(vx + 4, y + 132, v->dot);
    text(vx + 16, y + 132, v->caption, F_SMALL, C_MUTED, middle_left);
    if (v->id != 255) hit(vx - 10, y + 56, std::max(nw, 120) + 20, 90, ACT_GAUGE, v->id);
    vx += std::max(nw + (fit ? 40 : 24), fit ? 150 : 100);
  }
  const int ly = y + 156, avail = y + h - 20 - ly, h1 = avail * 6 / 10 - 5, h2 = avail - h1 - 10, lw = w - 44;
  chart(x + 22, ly, lw, h1, *la.h, la.col, la.lo, la.hi, la.zoom, la.sqrtY);
  chart(x + 22, ly + h1 + 10, lw, h2, *lb.h, lb.col, lb.lo, lb.hi, lb.zoom, lb.sqrtY);
  if (a.id != 255) hit(x, ly - 4, w, h1 + 9, ACT_GAUGE, a.id);
  if (b.id != 255) hit(x, ly + h1 + 5, w, h2 + 10, ACT_GAUGE, b.id);
}

// A slim card with a bar: icon, name, the bar, the percentage (and a chevron when it opens a page).
static void barCard(int x, int y, int w, int h, const char* icon, uint32_t col, const char* name, float pct, float warn,
                    float crit, uint8_t id, bool chevron = false) {
  card(x, y, w, h);
  const int cy = y + h / 2;
  text(x + 36, cy, icon, I_S, col, middle_center);
  text(x + 60, cy, name, F_BODYB, C_TEXT, middle_left);
  char buf[8] = "--";
  if (!isnan(pct)) snprintf(buf, sizeof buf, "%.0f%%", pct);
  const int rx = x + w - 22 - (chevron ? 34 : 0), bx = x + 60 + 100, bw = rx - 78 - bx;
  text(rx, cy, buf, F_STAT, isnan(pct) ? C_DIM : C_TEXT, middle_right);
  spr.fillSmoothRoundRect(bx, cy - 6, bw, 12, 6, C_TRACK);
  if (pct > 0) spr.fillSmoothRoundRect(bx, cy - 6, std::max(12, int(bw * clampf(pct, 0, 100) / 100)), 12, 6, sev(pct, warn, crit, col));
  if (chevron) text(x + w - 30, cy, ICON_CHEVRON_RIGHT, I_S, C_DIM, middle_center);
  hit(x, y, w, h, ACT_GAUGE, id);
}

// ---------- pages ----------
static void drawPcPage(const Data& d, bool on) {
  float cpu = on ? d.pcCpu : NAN, cpuT = on ? d.pcCpuT : NAN, gpu = on ? d.pcGpu : NAN,
        gpuT = on ? d.pcGpuT : NAN, ram = on ? d.pcRam : NAN;
  char note[24];
  snprintf(note, sizeof note, "last %d min", settings.graphMin);
  const int cw = (BODY_W - GAP) / 2, ch = 384;
  heroCard(M, TOP, cw, ch, ICON_DEVELOPER_BOARD_FILL, C_CYAN, "CPU", note,
           val(cpu, "%", "LOAD", sev(cpu, 80, 95, C_GREEN), G_PC_CPU),
           val(cpuT, DEGC, "TEMPERATURE", sev(cpuT, 75, 90, C_GREEN), G_PC_CPUT),
           {&hPcCpu, C_CYAN, 0, 100, true, false}, {&hPcCpuT, C_TEAL, 20, 100, true, false});
  heroCard(M + cw + GAP, TOP, cw, ch, ICON_VIDEOGAME_ASSET_FILL, C_PINK, "GPU", note,
           val(gpu, "%", "LOAD", C_GREEN, G_PC_GPU),  // a busy GPU is normal, not an alert
           val(gpuT, DEGC, "TEMPERATURE", sev(gpuT, 75, 85, C_GREEN), G_PC_GPUT),
           {&hPcGpu, C_PINK, 0, 100, true, false}, {&hPcGpuT, C_ORCHID, 20, 100, true, false});
  barCard(M, TOP + ch + 12, BODY_W, STATS_BOTTOM - (TOP + ch + 12), ICON_MEMORY_ALT_FILL, C_VIOLET, "Memory", ram, 85, 95,
          G_PC_RAM);
}

static float arrayPct(const Data& d, bool unraidOn) {
  return unraidOn && d.arraySizeKB > 0 ? 100 * (1 - d.arrayFreeKB / d.arraySizeKB) : NAN;
}

// Network rate as a hero value: "36" + "Mb/s".
static Val rateVal(float bps, const char* caption, uint32_t col) {
  Val r{{}, "", caption, col, 255};
  char buf[16];
  fmtRate(buf, sizeof buf, bps);
  char* sp = strchr(buf, ' ');
  if (sp) { *sp = 0; r.unit = bps >= 1e9f ? "Gb/s" : bps >= 1e6f ? "Mb/s" : "kb/s"; }
  snprintf(r.num, sizeof r.num, "%s", buf);
  return r;
}

// Like the desktop page with a third card for the network, and the array beside memory.
static void drawNasPage(const Data& d, bool on, bool unraidOn) {
  float cpu = on ? d.nasCpu : NAN, cpuT = on ? d.nasCpuT : NAN, gpu = on ? d.nasGpu : NAN, gpuT = on ? d.nasGpuT : NAN,
        ram = on ? d.nasRam : NAN;
  const int cw = (BODY_W - 2 * GAP) / 3, ch = 384;
  heroCard(M, TOP, cw, ch, ICON_DEVELOPER_BOARD_FILL, C_CYAN, "CPU", nullptr,
           val(cpu, "%", "LOAD", sev(cpu, 80, 95, C_GREEN), G_NAS_CPU),
           val(cpuT, DEGC, "TEMP", sev(cpuT, 80, 90, C_GREEN), G_NAS_CPUT),
           {&hNasCpu, C_CYAN, 0, 100, true, false}, {&hNasCpuT, C_TEAL, 20, 100, true, false});
  heroCard(M + cw + GAP, TOP, cw, ch, ICON_VIDEOGAME_ASSET_FILL, C_PINK, "GPU", nullptr,
           val(gpu, "%", "LOAD", C_GREEN, G_NAS_GPU),
           val(gpuT, DEGC, "TEMP", sev(gpuT, 80, 87, C_GREEN), G_NAS_GPUT),
           {&hNasGpu, C_PINK, 0, 100, true, false}, {&hNasGpuT, C_ORCHID, 20, 100, true, false});
  // Each lane scaled to its own peak over the graph window, so a big download doesn't flatten the upload line, on a
  // square-root axis so normal traffic stays visible next to that peak.
  heroCard(M + 2 * (cw + GAP), TOP, cw, ch, ICON_SWAP_VERT_FILL, C_CYAN, "Network", nullptr,
           rateVal(on ? d.nasRx : NAN, "DOWN", C_CYAN), rateVal(on ? d.nasTx : NAN, "UP", C_PINK),
           {&hRx, C_CYAN, 0, fmaxf(hRx.max(), 1e6f), false, true}, {&hTx, C_PINK, 0, fmaxf(hTx.max(), 1e6f), false, true});
  const int by = TOP + ch + 12, bw = (BODY_W - GAP) / 2;
  barCard(M, by, bw, STATS_BOTTOM - by, ICON_MEMORY_ALT_FILL, C_VIOLET, "Memory", ram, 85, 95, G_NAS_RAM);
  barCard(M + bw + GAP, by, bw, STATS_BOTTOM - by, ICON_HARD_DRIVE_FILL, C_TEAL, "Array", arrayPct(d, unraidOn), 85, 95,
          G_ARRAY, true);  // opens the storage page
}

// Free space large, a bar split per disk, then a tile per disk (four to a row; the last row's tiles share its width).
static void drawStoragePage(const Data& d, bool unraidOn) {
  const int sh = 120;
  card(M, TOP, BODY_W, sh);
  if (!d.nDisks) {
    text(M + 24, TOP + 24, *UNRAID_API_KEY ? "Waiting for Unraid API..." : "Set UNRAID_API_KEY in config.h", F_STAT, C_DIM);
    return;
  }
  char buf[48];
  snprintf(buf, sizeof buf, "%.1f TB", d.arrayFreeKB / 1e9);
  text(M + 24, TOP + 18, buf, F_HUGE, unraidOn ? C_TEXT : C_MUTED);
  int fx = M + 24 + spr.textWidth(buf) + 12;
  snprintf(buf, sizeof buf, "free of %.1f TB", d.arraySizeKB / 1e9);
  text(fx, TOP + 36, buf, F_STAT, C_MUTED);
  int asleep = 0, data = 0;
  for (int i = 0; i < d.nDisks; i++) {
    asleep += isnan(d.disks[i].temp) || d.disks[i].temp <= 0;
    data += strncmp(d.disks[i].name, "cache", 5) != 0;
  }
  snprintf(buf, sizeof buf, "%d data  /  %d cache  /  %d asleep", data, d.nDisks - data, asleep);
  text(M + BODY_W - 24, TOP + 40, buf, F_BODY, C_MUTED, top_right);
  float total = 0;
  for (int i = 0; i < d.nDisks; i++) total += d.disks[i].sizeTB;
  int sx = M + 24;
  const int sw = BODY_W - 48 - 4 * (d.nDisks - 1);
  for (int i = 0; i < d.nDisks; i++) {  // the bar: one segment per disk, as wide as its share of the capacity
    const Disk& k = d.disks[i];
    int w = i == d.nDisks - 1 ? M + 24 + BODY_W - 48 - sx : std::max(8, int(sw * k.sizeTB / total));
    spr.fillRoundRect(sx, TOP + 88, w, 14, 4, C_TRACK);
    spr.fillRoundRect(sx, TOP + 88, std::max(4, int(w * clampf(k.pct, 0, 100) / 100)), 14, 4, sev(k.pct, 85, 95, C_TEAL));
    sx += w + 4;
  }

  const int gy = TOP + sh + GAP, rows = (d.nDisks + 3) / 4, gap = rows > 2 ? 10 : GAP;
  const int th = (STATS_BOTTOM - gy - (rows - 1) * gap) / rows;
  const bool roomy = th >= 130;
  for (int i = 0; i < d.nDisks; i++) {
    const Disk& k = d.disks[i];
    const int row = i / 4, inRow = std::min(4, d.nDisks - row * 4), col = i % 4;
    const int tw = (BODY_W - (inRow - 1) * GAP) / inRow, x = M + col * (tw + GAP), y = gy + row * (th + gap);
    card(x, y, tw, th);
    hit(x, y, tw, th, ACT_DISK, i, k.name);
    text(x + 20, y + 18, k.name, F_TITLE, C_TEXT);
    int nx = x + 20 + spr.textWidth(k.name) + 8;
    snprintf(buf, sizeof buf, "%.0f TB", k.sizeTB);
    text(nx, y + 24, buf, F_BODY, C_MUTED);
    bool spun = isnan(k.temp) || k.temp <= 0;
    if (spun) {  // a dark pill with a moon: asleep is normal, not a status colour (narrow tiles: just the moon)
      spr.setFont(F_SMALL);
      const bool word = tw >= 280;
      const int pw = word ? spr.textWidth("asleep") + 42 : 32, px = x + tw - 18 - pw, py = y + 30;
      spr.fillSmoothRoundRect(px, py - 12, pw, 24, 12, field());
      text(px + 16, py, ICON_BEDTIME_FILL, I_XS, C_MUTED, middle_center);
      if (word) text(px + 28, py, "asleep", F_SMALL, C_MUTED, middle_left);
    } else {
      snprintf(buf, sizeof buf, "%.0f" DEGC, k.temp);
      bool ssd = !strncmp(k.name, "cache", 5);  // NVMe/SSD pools run warmer than spinning disks
      pill(x + tw - 18, y + 30, buf, ssd ? sev(k.temp, 60, 70, C_GREEN) : sev(k.temp, 45, 52, C_GREEN));
    }
    snprintf(buf, sizeof buf, "%.0f%%", k.pct);
    const int by = y + th - (roomy ? 44 : 22);
    text(x + 20, by - 8, buf, roomy ? F_BIG : F_TITLE, C_TEXT, bottom_left);
    spr.fillSmoothRoundRect(x + 20, by, tw - 40, 10, 5, C_TRACK);
    spr.fillSmoothRoundRect(x + 20, by, std::max(10, int((tw - 40) * clampf(k.pct, 0, 100) / 100)), 10, 5, sev(k.pct, 85, 95, C_TEAL));
    if (roomy) {
      float freeTB = k.sizeTB * (100 - k.pct) / 100;
      snprintf(buf, sizeof buf, freeTB < 1 ? "%.0f GB free" : "%.1f TB free", freeTB < 1 ? freeTB * 1000 : freeTB);
      text(x + 20, by + 18, buf, F_SMALL, C_MUTED);
    }
  }
}

// The NAS's containers, running first: status dot, name, uptime (or a status that isn't "running", in its colour),
// then CPU and memory bars with values. Bars are scaled to the busiest container, since most idle near 0%.
static void drawDockerPage(const Data& d, bool on) {
  card(M, TOP, BODY_W, STATS_BOTTOM - TOP);
  const int x0 = M + 24, right = M + BODY_W - 24;
  const int cMem = right - 230, cCpu = cMem - 290, cUp = cCpu - 110, cName = x0 + 26;
  const int hy = TOP + 26;
  text(cName, hy, "NAME", F_SMALL, C_DIM, middle_left);
  text(cUp, hy, "UP", F_SMALL, C_DIM, middle_left);
  text(cCpu, hy, "CPU", F_SMALL, C_DIM, middle_left);
  text(cMem, hy, "MEMORY", F_SMALL, C_DIM, middle_left);
  if (!d.nCtr) {
    text(cName, hy + 50, on ? "No containers. Mount /var/run/docker.sock in the Glances container."
                            : "Waiting for Glances...", F_BODY, C_DIM, middle_left);
    return;
  }
  float cpuMax = 10, memMax = 256;  // floors, so a near-idle list doesn't show full bars
  for (int i = 0; i < d.nCtr; i++)
    if (statusColor(d.ctr[i].status) != C_DIM) { cpuMax = fmaxf(cpuMax, d.ctr[i].cpu); memMax = fmaxf(memMax, d.ctr[i].memMB); }
  const int top = TOP + 44, rh = std::min(51, (STATS_BOTTOM - 8 - top) / d.nCtr);
  int row = 0;
  for (int pass = 0; pass < 2; pass++)  // running, then stopped
    for (int i = 0; i < d.nCtr; i++) {
      const Container& c = d.ctr[i];
      const uint32_t sc = statusColor(c.status);
      if ((sc == C_DIM) != (pass == 1)) continue;
      const int ry = top + row * rh, cy = ry + rh / 2;
      spr.drawFastHLine(x0, ry, right - x0, C_GRID);
      hit(M, ry, BODY_W, rh, ACT_CTR, i, c.name);
      row++;
      const bool live = on && sc != C_DIM;  // offline: the last known list, dimmed
      spr.fillSmoothCircle(x0 + 6, cy, 6, on ? sc : C_DIM);
      textFit(cName, cy, c.name, cUp - cName - 16, F_BODYB, live ? C_TEXT : C_MUTED, middle_left);
      const bool normal = sc == C_GREEN;  // the dot carries running/healthy; any other status replaces the uptime
      text(cUp, cy, normal ? c.uptime : c.status, F_SMALL, normal || !on || sc == C_DIM ? C_MUTED : sc, middle_left);
      spr.fillSmoothRoundRect(cCpu, cy - 5, 190, 10, 5, C_TRACK);
      spr.fillSmoothRoundRect(cMem, cy - 5, 130, 10, 5, C_TRACK);
      if (sc == C_DIM) continue;  // stopped: no stats
      const uint32_t ink = live ? C_TEXT : C_MUTED;
      if (c.cpu > 0.05f)
        spr.fillSmoothRoundRect(cCpu, cy - 5, std::max(10, int(190 * clampf(c.cpu / cpuMax, 0, 1))), 10, 5,
                                live ? sev(c.cpu, 80, 95, C_CYAN) : C_DIM);
      spr.fillSmoothRoundRect(cMem, cy - 5, std::max(10, int(130 * clampf(c.memMB / memMax, 0, 1))), 10, 5, live ? C_PINK : C_DIM);
      char buf[16];
      snprintf(buf, sizeof buf, "%.1f%%", c.cpu);
      text(cCpu + 202, cy, buf, F_BODY, ink, middle_left);
      fmtMem(buf, sizeof buf, c.memMB);
      text(right, cy, buf, F_BODY, ink, middle_right);
    }
}

// ---------- printer page ----------
// Bambu "stg_cur" sub-stage ids (the table ha-bambulab uses), shown in place of "Printing" while one is active.
static const char* const STAGES[] = {
    "Printing", "Auto bed leveling", "Heating bed", "Sweeping XY axes", "Changing filament", "Paused", "Filament runout",
    "Heating nozzle", "Calibrating extrusion", "Scanning bed surface", "Inspecting first layer", "Identifying build plate",
    "Calibrating micro lidar", "Homing toolhead", "Cleaning nozzle tip", "Checking extruder temp", "Paused by user",
    "Front cover fell off", "Calibrating lidar", "Calibrating flow", "Nozzle temp malfunction", "Bed temp malfunction",
    "Unloading filament", "Skipped step", "Loading filament", "Calibrating motor noise", "AMS lost",
    "Heatbreak fan too slow", "Chamber temp error", "Cooling chamber", "Paused by G-code", "Motor noise showoff",
    "Nozzle covered in filament", "Cutter error", "First layer error", "Nozzle clog"};

static bool prBusy(const Printer& p) {
  return !strcmp(p.state, "RUNNING") || !strcmp(p.state, "PREPARE") || !strcmp(p.state, "PAUSE");
}

// State pill: label and color.
static const char* prState(const Printer& p, uint32_t& col) {
  const int nStages = sizeof STAGES / sizeof *STAGES;
  if (p.err) { col = C_RED; return "Error"; }
  col = !strcmp(p.state, "RUNNING") ? C_GREEN : !strcmp(p.state, "PREPARE") ? C_VIOLET : !strcmp(p.state, "PAUSE") ? C_AMBER
      : !strcmp(p.state, "FAILED") ? C_RED : !strcmp(p.state, "FINISH") ? C_CYAN : C_DIM;
  if (prBusy(p) && p.stage > 0 && p.stage < nStages) return STAGES[p.stage];  // "Heating bed" beats "Printing"
  if (!strcmp(p.state, "RUNNING")) return "Printing";
  if (!strcmp(p.state, "PREPARE")) return "Preparing";
  if (!strcmp(p.state, "PAUSE")) return "Paused";
  if (!strcmp(p.state, "FINISH")) return "Finished";
  if (!strcmp(p.state, "FAILED")) return "Failed";
  if (!strcmp(p.state, "IDLE")) return "Idle";
  return *p.state ? p.state : "Waiting";
}

static void fmtMins(char* buf, size_t n, int mins) {
  if (mins >= 60) snprintf(buf, n, "%d h %02d min", mins / 60, mins % 60);
  else snprintf(buf, n, "%d min", mins);
}

// ---- camera ----
// The camera task decodes each JPEG at half size (uiCamDecode) and uiCamFrame copies the picture into camHalf. Each
// frame is then scaled once (per size) into a cached image, so the once-a-second redraws only copy pixels.
static LGFX_Sprite camHalf;  // the latest frame at half size (640x360)
static uint32_t camGen = 0;  // bumped per frame, so the cache knows to scale again

bool uiCamWanted() {
  return !home && app == FN_STATS && (detail == DET_CAMERA || (detail == DET_NONE && page == PAGE_PRINTER));
}

// A plain RGB565 sprite of w x h in PSRAM. Plain, not the panel's non-swapped format: the AA zoom mangles that one.
static bool sizeSprite(LGFX_Sprite& s, int w, int h) {
  if (s.width() == w && s.height() == h) return true;
  s.deleteSprite();
  s.setPsram(true);
  s.setColorDepth(16);
  return s.createSprite(w, h);
}

bool uiCamFrame(const LGFX_Sprite& half) {
  if (!sizeSprite(camHalf, half.width(), half.height())) return false;
  memcpy(camHalf.getBuffer(), const_cast<LGFX_Sprite&>(half).getBuffer(), size_t(half.width()) * half.height() * 2);
  camGen++;
  return uiCamWanted();
}

// Width and height from the JPEG's SOF0/SOF2 header.
static bool jpegSize(const uint8_t* d, size_t n, int& w, int& h) {
  for (size_t i = 2; i + 9 < n;) {
    if (d[i] != 0xFF) return false;
    uint8_t m = d[i + 1];
    if (m == 0xC0 || m == 0xC2) { h = d[i + 5] << 8 | d[i + 6]; w = d[i + 7] << 8 | d[i + 8]; return true; }
    i += 2 + (d[i + 2] << 8 | d[i + 3]);
  }
  return false;
}

// Decodes at exactly half size, which the JPEG decoder does natively (fast, no resampling); camImage then scales
// that with anti-aliasing. Letting drawJpg scale straight to the target size resamples nearest-neighbour, which
// drops or repeats whole rows and columns at regular intervals: a screen-door grid over the image.
bool uiCamDecode(LGFX_Sprite& dst, const uint8_t* jpg, size_t len) {
  int jw, jh;
  if (!jpegSize(jpg, len, jw, jh) || !sizeSprite(dst, jw / 2, jh / 2)) return false;
  return dst.drawJpg(jpg, len, 0, 0, jw / 2, jh / 2, 0, 0, 0.5f, 0.5f);
}

// Paints `under` over a rectangle's corners outside radius r, so a square image sits like a card.
// underBottom: another colour for the bottom corners (-1 = the same).
static void roundCorners(int x, int y, int w, int h, int r, uint32_t under, int64_t underBottom = -1) {
  for (int dy = 0; dy < r; dy++) {
    float fy = r - dy - 0.5f;
    int dx = r - int(sqrtf(r * r - fy * fy) + 0.5f);  // pixels outside the arc on this row
    if (dx <= 0) continue;
    for (int yy : {y + dy, y + h - 1 - dy}) {
      uint32_t c = yy > y + dy && underBottom >= 0 ? uint32_t(underBottom) : under;
      spr.drawFastHLine(x, yy, dx, c);
      spr.drawFastHLine(x + w - dx, yy, dx, c);
    }
  }
}

// The camera filling w x h (centre-cropped if the shape differs), with a red banner while the printer reports an
// error; a card with a message while there's no frame yet. full: the full-screen view (square corners, no chips,
// the banner at the top, clear of the progress line along the bottom).
static void camImage(const Printer& p, const Status& s, int x, int y, int w, int h, bool full = false) {
  static LGFX_Sprite cache;
  static uint32_t gen = 0;
  if (!camGen) {
    if (full) spr.fillRect(x, y, w, h, C_BG);
    else card(x, y, w, h);
    const char* msg = !*PRINTER_IP ? "Set PRINTER_IP in config.h"
                    : !s.printer   ? "Printer offline"
                                   : "Connecting to the camera...  (needs LAN Only Liveview on the printer)";
    text(x + w / 2, y + h / 2 - 34, ICON_VIDEOCAM_FILL, I_L, C_DIM, middle_center);
    text(x + w / 2, y + h / 2 + 30, msg, F_BODY, C_DIM, middle_center);
    return;
  }
  if (cache.width() != w || cache.height() != h) {
    if (!sizeSprite(cache, w, h)) { card(x, y, w, h); return; }
    gen = camGen - 1;  // new size: scale again
  }
  if (gen != camGen) {  // scale the half-size frame smoothly; pushSprite below converts to the panel's format
    float sc = std::max(float(w) / camHalf.width(), float(h) / camHalf.height());
    cache.fillScreen(C_BG);
    camHalf.pushRotateZoomWithAA(&cache, w / 2.0f, h / 2.0f, 0, sc, sc);  // centred, so any overflow crops evenly
    gen = camGen;
  }
  cache.pushSprite(&spr, x, y);
  if (!full) {
    roundCorners(x, y, w, h, 20, bgAt(y), bgAt(y + h));
    chip(x + w - 14, y + 28, s.cam ? "LIVE" : "Not live", s.cam ? C_GREEN : C_AMBER);  // a stale frame isn't taken as live
    spr.fillSmoothCircle(x + w - 34, y + h - 34, 20, C_BG);
    text(x + w - 34, y + h - 34, ICON_OPEN_IN_FULL, I_S, C_TEXT, middle_center);
  }
  if (s.printer && (p.err || !strcmp(p.state, "FAILED"))) {
    const int nStages = sizeof STAGES / sizeof *STAGES;
    char msg[80];
    int n = p.err ? snprintf(msg, sizeof msg, "Error %04X_%04X", unsigned(p.err >> 16), unsigned(p.err & 0xFFFF))
                  : snprintf(msg, sizeof msg, "Print failed");
    if (p.stage > 0 && p.stage < nStages) snprintf(msg + n, sizeof msg - n, "  /  %s", STAGES[p.stage]);
    const int bh = 48, bx = x + 14, by = full ? y + 70 : y + h - 14 - bh - 46, bw = w - 28 - (full ? 0 : 0);
    spr.fillSmoothRoundRect(bx, by, bw, bh, 16, C_RED);
    text(bx + 30, by + bh / 2, ICON_WARNING_FILL, I_S, C_BG, middle_center);
    textFit(bx + 52, by + bh / 2, msg, bw - 70, F_BODYB, C_BG, middle_left);  // dark on red: 6:1 contrast
  }
}

// What the printer is doing, for the progress card and the camera view: "42%", "1 h 23 min left", and a line with the
// layer and the clock time it should finish (not while paused: that time keeps slipping).
static void prProgress(const Printer& p, const tm* clock, char* left, size_t nl, char* line, size_t nline) {
  *left = *line = 0;
  if (p.mins >= 0) {
    char tag[24];
    fmtMins(tag, sizeof tag, p.mins);
    snprintf(left, nl, "%s left", tag);
  }
  if (p.layers) snprintf(line, nline, "layer %d / %d", p.layer, p.layers);
  if (strcmp(p.state, "PAUSE") && clock && p.mins > 0) {
    tm t = *clock;
    t.tm_min += p.mins;
    t.tm_sec = 0;
    t.tm_isdst = -1;  // let mktime work out DST for the finish time, in case the print runs across a change
    mktime(&t);
    char hm[16];
    const char* ampm = fmtClock(hm, sizeof hm, &t);
    size_t n = strlen(line);
    snprintf(line + n, nline - n, "%sdone %s%s%s", n ? "  /  " : "", hm, ampm ? " " : "", ampm ? ampm : "");
  }
}

// ---- page: camera first, progress underneath, details in a column beside it ----
constexpr int CAM_W = 624, CAM_H = CAM_W * 9 / 16;  // 16:9, like the camera

static void drawPrinterPage(const Data& d, const Status& s, const tm* clock) {
  const Printer& p = d.pr;
  const bool on = s.printer, busy = on && prBusy(p);
  uint32_t col = C_DIM;
  const char* st = !*PRINTER_IP ? "Not set up" : on ? prState(p, col) : "Offline";
  char buf[64], left[32], line[64];

  camImage(p, s, M, TOP, CAM_W, CAM_H);
  hit(M, TOP, CAM_W, CAM_H, ACT_CAM, 0);

  // ---- progress under the camera ----
  const int py = TOP + CAM_H + 12, ph = STATS_BOTTOM - py, px = M + 22, pw = CAM_W - 44;
  card(M, py, CAM_W, ph);
  if (busy) {
    snprintf(buf, sizeof buf, "%d%%", std::min(std::max(p.pct, 0), 100));
    text(px, py + 12, buf, F_BIG, C_TEXT);
    prProgress(p, clock, left, sizeof left, line, sizeof line);
    text(px + pw, py + 18, left, F_STAT, C_TEXT, top_right);
  } else {
    text(px, py + 20, st, F_BIG, C_MUTED);
    *line = 0;
  }
  const int by = py + ph - 20;
  spr.setFont(F_SMALL);
  const int lw = *line ? spr.textWidth(line) + 16 : 0;
  int pct = busy ? p.pct : on && !strcmp(p.state, "FINISH") ? 100 : 0;
  spr.fillSmoothRoundRect(px, by - 6, pw - lw, 12, 6, C_TRACK);
  if (pct > 0) spr.fillSmoothRoundRect(px, by - 6, std::max(12, (pw - lw) * std::min(pct, 100) / 100), 12, 6, busy ? C_TEAL : col);
  if (*line) text(px + pw, by, line, F_SMALL, C_MUTED, middle_right);

  // ---- column: job, nozzle, bed (tap for the graph), fans ----
  const int cx = M + CAM_W + 12, cw = BODY_W - CAM_W - 12, ix = cx + 20, iw = cw - 40;
  int y = TOP;
  card(cx, y, cw, 100);
  text(ix, y + 16, "JOB", F_SMALL, C_DIM);
  textFit(ix, y + 36, on && *p.name ? p.name : "No job", iw, F_BODYB, on && *p.name ? C_TEXT : C_DIM);
  static const char* const speeds[] = {"", "Silent", "Standard", "Sport", "Ludicrous"};
  if (on && p.err) {
    snprintf(buf, sizeof buf, "Error code %04X_%04X", unsigned(p.err >> 16), unsigned(p.err & 0xFFFF));
    text(ix, y + 66, buf, F_SMALL, C_RED);
  } else if (on) {
    snprintf(buf, sizeof buf, "%s%s%s%s", p.fil, *p.fil && p.speed >= 1 && p.speed <= 4 ? "  /  " : "",
             p.speed >= 1 && p.speed <= 4 ? speeds[p.speed] : "", p.speed >= 1 && p.speed <= 4 ? " speed" : "");
    text(ix, y + 66, buf, F_SMALL, p.speed >= 3 ? C_AMBER : C_MUTED);
  }
  y += 112;
  auto temp = [&](const char* icon, uint32_t c, const char* label, float cur, float tgt, uint8_t id) {
    card(cx, y, cw, 108);
    text(ix + 12, y + 24, icon, I_S, c, middle_center);
    text(ix + 32, y + 24, label, F_SMALL, C_DIM, middle_left);
    if (on && !isnan(cur)) snprintf(buf, sizeof buf, "%.0f" DEG, cur);
    else snprintf(buf, sizeof buf, "--");
    text(ix, y + 44, buf, F_BIG, on ? C_TEXT : C_DIM);
    snprintf(buf, sizeof buf, on && tgt > 0 ? "target %.0f" DEG : "off", tgt);
    text(ix + iw, y + 58, buf, F_BODY, C_MUTED, top_right);
    float f = on && tgt > 0 && !isnan(cur) ? clampf(cur / tgt, 0, 1) : 0;  // heating up toward the target
    spr.fillSmoothRoundRect(ix, y + 90, iw, 8, 4, C_TRACK);
    if (f > 0) spr.fillSmoothRoundRect(ix, y + 90, std::max(8, int(iw * f)), 8, 4, c);
    hit(cx, y, cw, 108, ACT_GAUGE, id);
    y += 120;
  };
  temp(ICON_WHATSHOT_FILL, C_PINK, "NOZZLE", p.noz, p.nozT, G_PR_NOZ);
  temp(ICON_HEAT_FILL, C_CYAN, "BED", p.bed, p.bedT, G_PR_BED);
  const int fh = STATS_BOTTOM - y;
  card(cx, y, cw, fh);
  text(ix + 12, y + 24, ICON_MODE_FAN_FILL, I_S, C_CYAN, middle_center);
  text(ix + 32, y + 24, "FANS", F_SMALL, C_DIM, middle_left);
  static const char* const fanL[] = {"Part", "Aux", "Chamber"};
  for (int i = 0; i < 3; i++) {
    int fx = ix + iw * i / 3;
    bool known = on && p.fan[i] >= 0;
    if (known) snprintf(buf, sizeof buf, "%d%%", p.fan[i]);
    text(fx, y + 44, known ? buf : "--", F_TITLE, known ? C_TEXT : C_DIM);
    text(fx, y + 74, fanL[i], F_SMALL, C_MUTED);
  }
}

// Full-screen camera, from a tap on the printer page's image. Any tap closes it.
static void drawCameraView(const Data& d, const Status& s, const tm* clock) {
  const Printer& p = d.pr;
  camImage(p, s, 0, 0, W, H, true);
  // Top: a back chip (any tap closes this view) and the clock.
  spr.setFont(F_BODYB);
  const int bw = 44 + spr.textWidth(PRINTER_NAME) + 70;
  spr.fillSmoothRoundRect(16, 14, bw, 44, 22, C_BG);
  text(38, 36, ICON_ARROW_BACK_IOS_NEW, I_S, C_TEXT, middle_center);
  text(60, 36, PRINTER_NAME, F_BODYB, C_TEXT, middle_left);
  dot(16 + bw - 50, 36, s.cam ? C_GREEN : C_AMBER);
  text(16 + bw - 40, 36, s.cam ? "live" : "stale", F_SMALL, C_MUTED, middle_left);
  if (clock) {
    char buf[16];
    const char* ampm = fmtClock(buf, sizeof buf, clock);
    spr.setFont(F_CLOCK);
    int cw = spr.textWidth(buf) + (ampm ? 30 : 0) + 32;
    spr.fillSmoothRoundRect(W - 16 - cw, 14, cw, 44, 22, C_BG);
    text(W - 32 - (ampm ? 30 : 0), 48, buf, F_CLOCK, C_TEXT, baseline_right);
    if (ampm) text(W - 32, 48, ampm, F_SMALL, C_MUTED, baseline_right);
  }
  // Bottom: a fade, the progress line, and a thin bar along the edge.
  for (int y = 508; y < H; y++) spr.fillRectAlpha(0, y, W, 1, std::min(235, (y - 508) * 6), mix(C_BG, 0x000000, 0.6f));
  if (!s.printer || !prBusy(p)) return;
  char pct[8], left[32], line[64];
  snprintf(pct, sizeof pct, "%d%%", std::min(std::max(p.pct, 0), 100));
  prProgress(p, clock, left, sizeof left, line, sizeof line);
  int x = 20;
  text(x, 572, pct, F_BIG, C_TEXT, baseline_left);
  x += spr.textWidth(pct) + 18;
  text(x, 572, left, F_STAT, C_TEXT, baseline_left);
  x += spr.textWidth(left) + 18;
  text(x, 572, line, F_BODY, C_MUTED, baseline_left);
  x += spr.textWidth(line) + 24;
  textFit(W - 20, 572, p.name, W - 20 - x, F_BODY, C_MUTED, baseline_right);
  spr.fillRect(0, H - 6, W, 6, C_TRACK);
  spr.fillRect(0, H - 6, W * std::min(std::max(p.pct, 0), 100) / 100, 6, C_TEAL);
}

// ---------- detail views: one full-screen graph per series, with stats over the graph window ----------
// A value split for display: "31" + "%", "3.4" + "GB", "61" + degrees C. Returns false for "--".
static bool fmtSplit(float v, const char* unit, char* num, size_t n, const char*& u) {
  u = unit;
  if (isnan(v)) { snprintf(num, n, "--"); return false; }
  if (!strcmp(unit, "MB")) {
    if (v >= 1024) { snprintf(num, n, "%.1f", v / 1024); u = "GB"; }
    else snprintf(num, n, "%.0f", v);
    return true;
  }
  bool tenth = v > 0 && v < 10 && !strcmp(unit, "%") && fabsf(v - roundf(v)) >= 0.05f;  // 0.4% and 2.5%, but 0% and 5%
  snprintf(num, n, tenth ? "%.1f" : "%.0f", v);
  return true;
}
static void fmtVal(char* buf, size_t n, float v, const char* unit) {
  char num[16];
  const char* u;
  if (!fmtSplit(v, unit, num, sizeof num, u)) snprintf(buf, n, "--");
  else snprintf(buf, n, "%s%s%s", num, !strcmp(u, "MB") || !strcmp(u, "GB") ? " " : "", u);
}

// hi <= lo: autoscale. none: shown for the current value when there's no reading (e.g. "asleep" for a disk).
struct Series { const Hist* h; uint32_t col; float lo, hi; const char* name; const char* unit; const char* none = "--"; };

// One series: its value, min/avg/max chips, and a chart with dashed gridlines, their values at the right and the
// time along the bottom. big: the single-series layout (112 px value); otherwise compact, for two stacked series.
static void detailSeries(const Series& s, int x, int y, int w, int h, bool big) {
  float mn = NAN, mx = NAN, sum = 0, now = NAN;
  int cnt = 0, first = -1;
  for (int i = 0; i < s.h->count; i++) {
    float v = s.h->at(i);
    if (isnan(v)) continue;
    if (first < 0) first = i;
    mn = isnan(mn) ? v : fminf(mn, v);
    mx = isnan(mx) ? v : fmaxf(mx, v);
    sum += v; cnt++; now = v;
  }
  char num[16], buf[48];
  const char* u;
  int cy;  // where the chart card starts
  if (big) {
    const bool has = fmtSplit(now, s.unit, num, sizeof num, u);
    const char* shown = has ? num : s.none;
    text(x + 8, y + 2, shown, has ? F_XL : F_HUGE, has ? s.col : C_DIM);
    int nx = x + 8 + spr.textWidth(shown) + 6;
    if (has) { text(nx, y + 22, u, F_BIG, C_MUTED); nx += spr.textWidth(u) + 14; }
    text(nx, y + 80, "now", F_BODY, C_MUTED);
    cy = y + 128;
  } else {
    card(x, y, w, h);
    text(x + 22, y + 22, s.name, F_SMALL, C_DIM);
    const bool has = fmtSplit(now, s.unit, num, sizeof num, u);
    text(x + 22, y + 40, has ? num : s.none, F_BIG, has ? s.col : C_DIM);
    if (has) text(x + 22 + spr.textWidth(num) + 6, y + 52, u, F_BODY, C_MUTED);
    cy = y;
  }
  // Chips, right-aligned: MIN, AVG, MAX.
  const struct { const char* cap; float v; } st[] = {{"MAX", mx}, {"AVG", cnt ? sum / cnt : NAN}, {"MIN", mn}};
  int rx = x + w - (big ? 0 : 22);
  for (auto& c : st) {
    fmtVal(buf, sizeof buf, c.v, s.unit);
    spr.setFont(F_TITLE);
    const int cw = std::max(100, int(spr.textWidth(buf)) + 36), ch = 64, ty = big ? y + 18 : y + 16;
    spr.fillSmoothRoundRect(rx - cw, ty, cw, ch, 16, big ? C_CARD : field());
    text(rx - 18, ty + 10, c.cap, F_SMALL, C_DIM, top_right);
    text(rx - 18, ty + ch - 8, buf, F_TITLE, C_TEXT, bottom_right);
    rx -= cw + 12;
  }
  // The chart.
  int gx, gy, gw, gh;
  if (big) {
    card(x, cy, w, y + h - cy);
    gx = x + 22; gy = cy + 22; gw = w - 44 - 56; gh = y + h - cy - 22 - 46;
  } else {
    gx = x + 22; gy = y + 92; gw = w - 44 - 56; gh = h - 92 - 40;
  }
  float hi = s.hi > s.lo ? s.hi : fmaxf(isnan(mx) ? 1 : mx * 1.15f, s.lo + 1);
  float vlo = s.lo, vhi = hi;
  if (s.hi > s.lo) { auto r = fitRange(*s.h, s.lo, hi); vlo = r.first; vhi = r.second; }
  for (int k = 1; k <= 3; k++) {
    const int ly = gy + gh - gh * k / 4;
    for (int dx = gx; dx < gx + gw; dx += 8) spr.drawFastHLine(dx, ly, 3, C_TRACK);
    fmtVal(buf, sizeof buf, vlo + (vhi - vlo) * k / 4, s.unit);
    text(gx + gw + 56, ly, buf, F_SMALL, C_DIM, middle_right);
  }
  chart(gx, gy, gw, gh, *s.h, s.col, vlo, vhi, false);
  // Explain an empty graph, or the empty stretch before this series' history starts.
  int emptyW = first < 0 ? gw : XScale(gx, gw, s.h->count).xa(first) - gx;
  if (first < 0) snprintf(buf, sizeof buf, "No readings in the last %d min", settings.graphMin);
  else snprintf(buf, sizeof buf, "No data yet");
  spr.setFont(F_BODY);
  if (emptyW > spr.textWidth(buf) + 40) text(gx + emptyW / 2, gy + gh / 2, buf, F_BODY, C_DIM, middle_center);
  snprintf(buf, sizeof buf, "%d min ago", settings.graphMin);
  text(gx, gy + gh + 12, buf, F_SMALL, C_DIM);
  text(gx + gw, gy + gh + 12, "now", F_SMALL, C_DIM, top_right);
}

// Returns false if the thing being detailed has gone (e.g. a container was removed): caller goes back.
static bool drawDetail(const Status& s, const tm* clock) {
  char sub[80];
  if (detail == DET_GAUGE) {
    enum : uint8_t { PC, NAS, PRINTER = 4 };  // src: also the offTxt index
    struct G { const char* title; const char* host; uint8_t src; const Hist* h; uint32_t col; float lo, hi; const char* unit; };
    const G g[] = {
        {"CPU load", PC_NAME, PC, &hPcCpu, C_CYAN, 0, 100, "%"},
        {"CPU temperature", PC_NAME, PC, &hPcCpuT, C_TEAL, 20, 100, DEGC},
        {"GPU load", PC_NAME, PC, &hPcGpu, C_PINK, 0, 100, "%"},
        {"GPU temperature", PC_NAME, PC, &hPcGpuT, C_ORCHID, 20, 100, DEGC},
        {"Memory", PC_NAME, PC, &hPcRam, C_VIOLET, 0, 100, "%"},
        {"CPU load", NAS_NAME, NAS, &hNasCpu, C_CYAN, 0, 100, "%"},
        {"CPU temperature", NAS_NAME, NAS, &hNasCpuT, C_TEAL, 20, 100, DEGC},
        {"Memory", NAS_NAME, NAS, &hNasRam, C_VIOLET, 0, 100, "%"},
        {"GPU load", NAS_NAME, NAS, &hNasGpu, C_PINK, 0, 100, "%"},
        {"GPU temperature", NAS_NAME, NAS, &hNasGpuT, C_ORCHID, 20, 100, DEGC},
        {"Nozzle temperature", PRINTER_NAME, PRINTER, &hPrNoz, C_PINK, 20, 300, DEGC},
        {"Bed temperature", PRINTER_NAME, PRINTER, &hPrBed, C_CYAN, 20, 120, DEGC}};
    const G& e = g[detailGauge];
    snprintf(sub, sizeof sub, "%s  /  tap anywhere to close", e.host);
    bool online = e.src == PC ? s.pc : e.src == NAS ? s.nas : s.printer;
    background(e.col);
    statusBar(clock, s.wifi, "", e.col, e.title, sub, 0, online, offTxt[e.src], true);
    detailSeries({e.h, e.col, e.lo, e.hi, e.title, e.unit}, M, TOP, BODY_W, BOTTOM - TOP, true);
    return true;
  }
  Named* h = detail == DET_DISK ? named(diskH, MAX_DISKS, detailName, false) : named(ctrH, MAX_CTR, detailName, false);
  if (!h) return false;
  const int hh = (BOTTOM - TOP - GAP) / 2;
  background(C_CYAN);
  if (detail == DET_DISK) {
    snprintf(sub, sizeof sub, NAS_NAME " disk  /  tap anywhere to close");
    statusBar(clock, s.wifi, "", C_CYAN, detailName, sub, 0, s.unraid, offTxt[2], true);
    detailSeries({&h->a, C_PINK, 20, 60, "TEMPERATURE", DEGC, "asleep"}, M, TOP, BODY_W, hh, false);
    detailSeries({&h->b, C_TEAL, 0, 100, "USED", "%"}, M, TOP + hh + GAP, BODY_W, hh, false);
  } else {
    snprintf(sub, sizeof sub, NAS_NAME " container  /  tap anywhere to close");
    statusBar(clock, s.wifi, "", C_CYAN, detailName, sub, 0, s.docker, offTxt[3], true);
    detailSeries({&h->a, C_CYAN, 0, 0, "CPU", "%"}, M, TOP, BODY_W, hh, false);
    detailSeries({&h->b, C_PINK, 0, 0, "MEMORY", "MB"}, M, TOP + hh + GAP, BODY_W, hh, false);
  }
  return true;
}

// ---------- settings: runtime-adjustable, saved to flash by main.cpp ----------
Settings settings = {1, BL_DAY, SLEEP_MINUTES, NIGHT_ON, NIGHT_FROM, NIGHT_TO, BL_NIGHT, PAGE_SECONDS, CLOCK_24H,
                      GRAPH_MINUTES, START_PAGE, PANEL_FUNCTION, RADAR_ZIP, RADAR_PLACE, RADAR_LAT, RADAR_LON, 0};

enum Op : uint8_t {
  OP_BACK, OP_BRIGHT_DN, OP_BRIGHT_UP, OP_NBRIGHT_DN, OP_NBRIGHT_UP, OP_NFROM_DN, OP_NFROM_UP, OP_NTO_DN, OP_NTO_UP,
  OP_NIGHT, OP_RESTART, OP_FUNC_OPEN,
  OP_SLEEP = 32,  // + option index
  OP_ROT = 40,    // + option index
  OP_CLOCK = 48,  // + 0 (12 h) / 1 (24 h)
  OP_GRAPH = 56,  // + option index
  OP_START = 64,  // + page
  OP_FUNC = 72,   // + Function (dropdown list entries; keep last)
};
static bool isDropOption(uint8_t op) { return op >= OP_FUNC; }
static const uint8_t SLEEP_OPTS[] = {0, 5, 10, 30, 60}, ROT_OPTS[] = {0, 15, 30, 60}, GRAPH_OPTS[] = {15, 30, 60};
static bool settingsChanged = false, restartArmed = false, restartNow = false;

bool uiTakeSettingsChanged() { bool c = settingsChanged; settingsChanged = false; return c; }
bool uiTakeRestart() { bool r = restartNow; restartNow = false; return r; }

static int toPct(uint8_t v) { return (v * 100 + 127) / 255; }
static uint8_t stepPct(uint8_t v, int dir) {  // backlight in 10% steps, never fully off
  int pct = (toPct(v) + 5) / 10 * 10 + dir * 10;
  return std::min(std::max(pct, 10), 100) * 255 / 100;
}

static void applyOp(uint8_t op) {
  if (op != OP_RESTART) restartArmed = false;
  Settings before = settings;
  switch (op) {
    case OP_BACK: detail = DET_NONE; dropOpen = false; return;
    case OP_BRIGHT_DN: settings.brightness = stepPct(settings.brightness, -1); break;
    case OP_BRIGHT_UP: settings.brightness = stepPct(settings.brightness, +1); break;
    case OP_NBRIGHT_DN: settings.nightBright = stepPct(settings.nightBright, -1); break;
    case OP_NBRIGHT_UP: settings.nightBright = stepPct(settings.nightBright, +1); break;
    case OP_NFROM_DN: settings.nightFrom = (settings.nightFrom + 23) % 24; break;
    case OP_NFROM_UP: settings.nightFrom = (settings.nightFrom + 1) % 24; break;
    case OP_NTO_DN: settings.nightTo = (settings.nightTo + 23) % 24; break;
    case OP_NTO_UP: settings.nightTo = (settings.nightTo + 1) % 24; break;
    case OP_NIGHT: settings.nightOn = !settings.nightOn; break;
    case OP_FUNC_OPEN: dropOpen = !dropOpen; return;
    case OP_RESTART:  // two taps, so a stray touch can't reboot the panel
      if (restartArmed) restartNow = true;
      restartArmed = true;
      return;
    default:
      if (op >= OP_FUNC) {  // takes effect at once: going back from settings lands in the new Function
        settings.function = op - OP_FUNC;
        dropOpen = false;
        openFunction();
      } else if (op >= OP_START) settings.startPage = op - OP_START;
      else if (op >= OP_GRAPH) {
        settings.graphMin = GRAPH_OPTS[op - OP_GRAPH];
        if (settings.graphMin != before.graphMin) clearHistory();
      } else if (op >= OP_CLOCK) settings.clock24 = op - OP_CLOCK;
      else if (op >= OP_ROT) settings.rotateSec = ROT_OPTS[op - OP_ROT];
      else if (op >= OP_SLEEP) settings.sleepMin = SLEEP_OPTS[op - OP_SLEEP];
  }
  settingsChanged |= memcmp(&before, &settings, sizeof settings) != 0;
}

static void fmtHour(char* buf, size_t n, int h) {
  if (settings.clock24) snprintf(buf, n, "%02d:00", h);
  else snprintf(buf, n, "%d %s", (h + 11) % 12 + 1, h < 12 ? "AM" : "PM");
}

// ---- controls (each registers its own tap targets) ----
// A rounded button: a label, or for "+" / "-" the add and remove icons (so both match in width and weight).
static void button(int x, int y, int w, int h, const char* label, uint32_t col, uint8_t op, uint32_t bg = 0) {
  spr.fillSmoothRoundRect(x, y, w, h, h / 2, bg ? bg : field());
  if ((label[0] == '+' || label[0] == '-') && !label[1])
    text(x + w / 2, y + h / 2, label[0] == '+' ? ICON_ADD : ICON_REMOVE, I_S, col, middle_center);
  else
    text(x + w / 2, y + h / 2, label, F_BODYB, col, middle_center);
  hit(x - 6, y - 5, w + 12, h + 10, ACT_SET, op);  // a little larger than drawn
}

// rx = right edge; returns the left edge. mid = width of the value between the buttons.
static int stepper(int rx, int cy, const char* value, uint8_t opDn, uint8_t opUp, bool dim, int mid = 96) {
  uint32_t c = dim ? C_MUTED : C_TEXT;
  button(rx - 44, cy - 20, 44, 40, "+", c, opUp);
  text(rx - 44 - mid / 2, cy, value, F_STAT, c, middle_center);
  button(rx - 44 - mid - 44, cy - 20, 44, 40, "-", c, opDn);
  return rx - 44 - mid - 44;
}

// track: the control's backing (0 = the usual field colour; the radar's floats on the map use the base colour).
static void segmented(int rx, int cy, const char* const* labels, int n, int sel, uint8_t opBase, int sw = 62,
                      Act act = ACT_SET, uint32_t track = 0, uint32_t accent = 0) {
  const int sh = 40, x0 = rx - n * sw - 6;
  spr.fillSmoothRoundRect(x0, cy - sh / 2, n * sw + 6, sh, sh / 2, track ? track : field());
  for (int i = 0; i < n; i++) {
    int x = x0 + 3 + i * sw;
    if (i == sel) spr.fillSmoothRoundRect(x, cy - sh / 2 + 3, sw, sh - 6, (sh - 6) / 2, mix(accent ? accent : C_CYAN, C_CARD, 0.32f));
    text(x + sw / 2, cy, labels[i], F_BODY, i == sel ? C_TEXT : C_MUTED, middle_center);
    hit(x, cy - sh / 2 - 5, sw, sh + 10, act, opBase + i);
  }
}

static void toggle(int rx, int cy, bool on, uint8_t op) {
  const int tw = 62, th = 34, x = rx - tw;
  spr.fillSmoothRoundRect(x, cy - th / 2, tw, th, th / 2, on ? mix(C_GREEN, C_CARD, 0.6f) : field());
  spr.fillSmoothCircle(on ? x + tw - th / 2 : x + th / 2, cy, th / 2 - 4, on ? C_TEXT : C_MUTED);
  text(x - 14, cy, on ? "On" : "Off", F_BODY, on ? C_TEXT : C_MUTED, middle_right);
  hit(x - 60, cy - th / 2 - 8, tw + 60, th + 16, ACT_SET, op);
}

static void fmtAge(char* buf, size_t n, uint32_t s) {
  if (s == UINT32_MAX) snprintf(buf, n, "never");
  else if (s < 120) snprintf(buf, n, "%u s ago", unsigned(s));
  else if (s < 7200) snprintf(buf, n, "%u min ago", unsigned(s / 60));
  else snprintf(buf, n, "%u h ago", unsigned(s / 3600));
}

static void drawSettings(const Status& st, const tm* clock, const SysInfo& sys) {
  background(C_BLUE);
  statusBar(clock, st.wifi, "", C_BLUE, "Settings", "saved automatically  /  swipe or tap the arrow to go back", 0, true,
            nullptr, true);
  char buf[48];

  // ---- left: display controls, a row each ----
  const int lw = 600, lx = M, rx = lx + lw - 22, rowH = 57;
  card(lx, TOP, lw, BOTTOM - TOP);
  int cy = TOP + 6 + rowH / 2, row = 0;
  auto label = [&](const char* icon, const char* s, bool dim = false) {
    if (row++) spr.drawFastHLine(lx + 22, cy - rowH / 2, lw - 44, C_GRID);
    text(lx + 36, cy, icon, I_S, dim ? C_DIM : C_MUTED, middle_center);
    text(lx + 62, cy, s, F_BODY, dim ? C_MUTED : C_TEXT, middle_left);
  };
  auto next = [&]() { cy += rowH; };

  label(ICON_LIGHT_MODE_FILL, "Brightness");
  snprintf(buf, sizeof buf, "%d%%", toPct(settings.brightness));
  stepper(rx, cy, buf, OP_BRIGHT_DN, OP_BRIGHT_UP, false);
  next();

  static const char* const sleepL[] = {"Off", "5", "10", "30", "60"};
  label(ICON_BEDTIME_FILL, "Screen sleep (min)");
  int sel = 0;
  for (int i = 0; i < 5; i++) if (SLEEP_OPTS[i] == settings.sleepMin) sel = i;
  segmented(rx, cy, sleepL, 5, sel, OP_SLEEP, 56);
  next();

  static const char* const rotL[] = {"Off", "15", "30", "60"};
  label(ICON_AUTORENEW_FILL, "Auto-rotate pages (s)");
  sel = 0;
  for (int i = 0; i < 4; i++) if (ROT_OPTS[i] == settings.rotateSec) sel = i;
  segmented(rx, cy, rotL, 4, sel, OP_ROT, 56);
  next();

  static const char* const startL[PAGE_COUNT] = {"PC", "NAS", "Disks", "Docker", "Print"};  // index = startPage
  label(ICON_HOME_FILL, "Stats start page");
  segmented(rx, cy, startL, PAGE_COUNT, settings.startPage, OP_START, 70);
  next();

  static const char* const graphL[] = {"15", "30", "60"};
  label(ICON_SHOW_CHART_FILL, "Graph window (min)");
  sel = 0;
  for (int i = 0; i < 3; i++) if (GRAPH_OPTS[i] == settings.graphMin) sel = i;
  segmented(rx, cy, graphL, 3, sel, OP_GRAPH, 56);
  next();

  static const char* const clockL[] = {"12 h", "24 h"};
  label(ICON_SCHEDULE_FILL, "Clock");
  segmented(rx, cy, clockL, 2, settings.clock24, OP_CLOCK, 70);
  next();

  label(ICON_DARK_MODE_FILL, "Night mode");
  toggle(rx, cy, settings.nightOn, OP_NIGHT);
  next();

  const bool dim = !settings.nightOn;  // night rows stay editable, just quieter while night mode is off
  label(ICON_NIGHTS_STAY_FILL, "Night hours", dim);  // start and end share a row: "10 PM  to  7 AM"
  fmtHour(buf, sizeof buf, settings.nightTo);
  int left = stepper(rx, cy, buf, OP_NTO_DN, OP_NTO_UP, dim, 76);
  text(left - 16, cy, "to", F_BODY, C_MUTED, middle_center);
  fmtHour(buf, sizeof buf, settings.nightFrom);
  stepper(left - 32, cy, buf, OP_NFROM_DN, OP_NFROM_UP, dim, 76);
  next();

  label(ICON_BRIGHTNESS_LOW_FILL, "Night brightness", dim);
  snprintf(buf, sizeof buf, "%d%%", toPct(settings.nightBright));
  stepper(rx, cy, buf, OP_NBRIGHT_DN, OP_NBRIGHT_UP, dim);

  // ---- right: the panel's Function, status, data sources, restart ----
  const int sx = lx + lw + 12, sw = BODY_W - lw - 12, srx = sx + sw - 22;
  card(sx, TOP, sw, BOTTOM - TOP);
  // Function: a dropdown, so more can be added without crowding the row. Its list is drawn last, on top.
  static const char* const fnL[FN_COUNT] = {"Server Stats", "Macro Pad", "Launcher", "Stream Deck", "Weather Radar",
                                            "Spotify"};
  const int dw = 200, dh = 44, dx = srx - dw, dy = TOP + 18;
  text(sx + 36, dy + dh / 2, ICON_WIDGETS_FILL, I_S, C_CYAN, middle_center);
  text(sx + 62, dy + dh / 2, "Function", F_BODY, C_TEXT, middle_left);
  spr.fillSmoothRoundRect(dx, dy, dw, dh, 14, field());
  text(dx + 16, dy + dh / 2, fnL[settings.function], F_BODY, C_TEXT, middle_left);
  text(dx + dw - 22, dy + dh / 2, dropOpen ? ICON_EXPAND_LESS : ICON_EXPAND_MORE, I_S, C_MUTED, middle_center);
  hit(dx, dy, dw, dh, ACT_SET, OP_FUNC_OPEN);

  int y = TOP + 88;
  text(sx + 22, y, "STATUS", F_SMALL, C_DIM, middle_left);
  y += 30;
  auto row2 = [&](const char* icon, const char* k, const char* v, uint32_t vc) {
    text(sx + 36, y, icon, I_S, C_DIM, middle_center);
    text(sx + 62, y, k, F_BODY, C_MUTED, middle_left);
    text(srx, y, v, F_BODY, vc, middle_right);
    y += 32;
  };
  if (st.wifi) {
    const char* q = sys.rssi > -60 ? "excellent" : sys.rssi > -70 ? "good" : sys.rssi > -80 ? "fair" : "weak";
    snprintf(buf, sizeof buf, "%s, %d dBm", q, sys.rssi);
    row2(ICON_WIFI, "Wi-Fi", buf, sys.rssi > -80 ? C_TEXT : C_AMBER);
    row2(ICON_LAN, "IP address", sys.ip, C_TEXT);
  } else {
    row2(ICON_WIFI, "Wi-Fi", "connecting...", C_AMBER);
  }
  uint32_t u = sys.uptimeS;
  if (u >= 86400) snprintf(buf, sizeof buf, "%u d %u h", unsigned(u / 86400), unsigned(u % 86400 / 3600));
  else if (u >= 3600) snprintf(buf, sizeof buf, "%u h %u min", unsigned(u / 3600), unsigned(u % 3600 / 60));
  else snprintf(buf, sizeof buf, "%u min", unsigned(u / 60));
  row2(ICON_TIMER, "Uptime", buf, C_TEXT);
  snprintf(buf, sizeof buf, "%u KB / %u MB", unsigned(sys.heapKB), unsigned(sys.psramKB / 1024));
  row2(ICON_MEMORY, "RAM / PSRAM", buf, C_TEXT);

  y += 4;
  text(sx + 22, y, "DATA SOURCES", F_SMALL, C_DIM, middle_left);
  y += 28;
  const struct { const char* name; bool ok; } src[] = {{"Desktop (LHM)", st.pc}, {"NAS (Glances)", st.nas},
      {"Unraid API", st.unraid}, {"Docker", st.docker}, {"Printer (MQTT)", st.printer}};
  for (int i = 0; i < 5; i++) {
    bool never = sys.ageS[i] == UINT32_MAX;
    dot(sx + 36, y, src[i].ok ? C_GREEN : never ? C_DIM : C_RED);
    text(sx + 62, y, src[i].name, F_BODY, C_TEXT, middle_left);
    fmtAge(buf, sizeof buf, sys.ageS[i]);
    text(srx, y, buf, F_SMALL, src[i].ok ? C_MUTED : C_TEXT, middle_right);
    y += 27;
  }
  if (*SPOTIFY_REFRESH) {
    dot(sx + 36, y, st.spotify ? C_GREEN : C_DIM);
    text(sx + 62, y, "Spotify", F_BODY, C_TEXT, middle_left);
    text(srx, y, st.spotify ? "connected" : "when open", F_SMALL, C_MUTED, middle_right);
  }

  const int bh = 48, bx = sx + 22, bw = sw - 44, by = BOTTOM - 18 - bh;  // warning-coloured: it reboots the panel
  const uint32_t rc = restartArmed ? C_RED : C_AMBER;
  spr.fillSmoothRoundRect(bx, by, bw, bh, bh / 2, mix(rc, C_CARD, 0.45f));
  spr.fillSmoothRoundRect(bx + 2, by + 2, bw - 4, bh - 4, bh / 2 - 2, mix(rc, C_CARD, 0.12f));
  const char* rl = restartArmed ? "Tap again to restart" : "Restart panel";
  spr.setFont(F_BODYB);
  const int tx = bx + (bw - spr.textWidth(rl) - 36) / 2;
  text(tx + 12, by + bh / 2, ICON_RESTART_ALT, I_S, rc, middle_center);
  text(tx + 36, by + bh / 2, rl, F_BODYB, rc, middle_left);
  hit(bx - 6, by - 5, bw + 12, bh + 10, ACT_SET, OP_RESTART);

  if (dropOpen) {  // the Function list, over the status rows
    int ly = dy + dh + 6;
    spr.fillSmoothRoundRect(dx - 2, ly + 2, dw + 6, FN_COUNT * dh + 14, 16, C_BG);  // drop shadow: reads as floating
    spr.fillSmoothRoundRect(dx, ly, dw, FN_COUNT * dh + 8, 14, C_TRACK);
    for (int i = 0; i < FN_COUNT; i++) {
      int oy = ly + 4 + i * dh;
      if (i == settings.function) spr.fillSmoothRoundRect(dx + 4, oy, dw - 8, dh, 12, mix(C_CYAN, C_CARD, 0.32f));
      text(dx + 16, oy + dh / 2, fnL[i], F_BODY, i == settings.function ? C_TEXT : C_MUTED, middle_left);
      hit(dx, oy, dw, dh, ACT_SET, OP_FUNC + i);
    }
  }
}

// ---------- launcher, macro pad, stream deck ----------
// Media keys' icons, from the key's consumer usage (config.h MACRO_KEYS), for keys without an icon of their own.
static const char* mediaGlyph(uint16_t code) {
  return code == 0xCD ? ICON_PLAY_PAUSE_FILL : code == 0xB5 ? ICON_SKIP_NEXT_FILL : code == 0xB6 ? ICON_SKIP_PREVIOUS_FILL
       : code == 0xE2 ? ICON_VOLUME_OFF_FILL : code == 0xE9 ? ICON_VOLUME_UP_FILL : code == 0xEA ? ICON_VOLUME_DOWN_FILL
       : nullptr;
}

// Macro pad: a grid of keys (config.h MACRO_KEYS), each an icon, its label and its shortcut; a tap is sent to the PC
// as a USB keystroke by main.cpp.
static void drawMacroPad(const Status& s, const tm* clock) {
  background(C_PINK);
  statusBar(clock, true, ICON_KEYBOARD_FILL, C_PINK, "Macro Pad", "USB connected  /  swipe up for home", C_GREEN, s.usb,
            "USB not connected: plug the board's USB-A port into the PC");
  const int cols = 4, rows = (N_MACROS + cols - 1) / cols, g = 12;
  const int kw = (BODY_W - (cols - 1) * g) / cols, kh = (BOTTOM - TOP - (rows - 1) * g) / rows;
  for (int i = 0; i < N_MACROS; i++) {
    const Macro& m = MACROS[i];
    const int x = M + i % cols * (kw + g), y = TOP + i / cols * (kh + g), cx = x + kw / 2, cy = y + kh / 2;
    spr.fillSmoothRoundRect(x, y, kw, kh, 20, i == macroFlash ? mix(C_PINK, C_CARD, 0.28f) : C_CARD);
    const char* icon = m.icon ? m.icon : m.kind == MK_MEDIA ? mediaGlyph(m.code) : nullptr;
    if (icon) {
      text(cx, cy - 36, icon, I_M, C_PINK, middle_center);
      textFit(cx, cy + 6, m.label, kw - 24, F_TITLE, C_TEXT, middle_center);
      textFit(cx, cy + 36, m.hint, kw - 24, F_SMALL, C_MUTED, middle_center);
    } else {
      textFit(cx, cy - 10, m.label, kw - 24, F_TITLE, C_TEXT, middle_center);
      textFit(cx, cy + 22, m.hint, kw - 24, F_SMALL, C_MUTED, middle_center);
    }
    hit(x, y, kw, kh, ACT_MACRO, i);
  }
  macroFlash = -1;
}

static LGFX_Sprite deckImg[DECK_KEYS];
static bool deckHas[DECK_KEYS];

void uiDeckKey(int key, const uint8_t* data, size_t len, bool png) {
  if (key < 0 || key >= DECK_KEYS) return;
  LGFX_Sprite& k = deckImg[key];
  deckHas[key] = false;
  if (!len) return;
  if (!k.getBuffer()) {
    k.setPsram(true);
    k.setColorDepth(16);
    if (!k.createSprite(DECK_PX, DECK_PX)) return;
  }
  k.fillScreen(0);
  if (png) deckHas[key] = k.drawPng(data, len, 0, 0, DECK_PX, DECK_PX);
  else if (len == DECK_PX * DECK_PX * 3) {  // raw RGB888, row by row
    for (int i = 0; i < DECK_PX * DECK_PX; i++, data += 3) k.drawPixel(i % DECK_PX, i / DECK_PX, lgfx::color888(data[0], data[1], data[2]));
    deckHas[key] = true;
  }
}

static void drawDeck(const Status& s, const tm* clock) {
  background(C_TEAL);
  statusBar(clock, true, ICON_GRID_VIEW_FILL, C_TEAL, "Stream Deck", "Companion connected  /  swipe up for home", C_GREEN,
            s.deck, *COMPANION_HOST ? "Companion not connected: is it running at " COMPANION_HOST "?"
                                    : "Set COMPANION_HOST in config.h");
  const int g = 10, x0 = (W - DECK_COLS * DECK_PX - (DECK_COLS - 1) * g) / 2, y0 = TOP + 2;
  for (int i = 0; i < DECK_KEYS; i++) {
    const int x = x0 + i % DECK_COLS * (DECK_PX + g), y = y0 + i / DECK_COLS * (DECK_PX + g);
    uint32_t top = bgAt(y), bottom = bgAt(y + DECK_PX);
    if (i == deckFlash) {  // tapped: a ring around the key for one frame (Companion's own pressed look follows)
      top = bottom = mix(C_CYAN, C_BG, 0.6f);
      spr.fillSmoothRoundRect(x - 5, y - 5, DECK_PX + 10, DECK_PX + 10, 22, top);
    }
    if (deckHas[i] && s.deck) {
      deckImg[i].pushSprite(&spr, x, y);
      roundCorners(x, y, DECK_PX, DECK_PX, 18, top, bottom);
    } else {
      spr.fillSmoothRoundRect(x, y, DECK_PX, DECK_PX, 18, C_CARD);
    }
    hit(x - g / 2, y - g / 2, DECK_PX + g, DECK_PX + g, ACT_DECK, i);  // gaps count: fingers are big
  }
  deckFlash = -1;
}

// ---------- weather radar: NOAA radar over an Esri dark gray map (radar.cpp downloads; the image work is here) ----------
void uiRadarOrigin(float lat, float lon, int z, double& left, double& top) {
  const double world = 256.0 * (1 << z), s = sin(lat * M_PI / 180);
  const double cx = (lon + 180) / 360 * world, cy = (0.5 - log((1 + s) / (1 - s)) / (4 * M_PI)) * world;
  left = floor(cx - RADAR_W / 2.0);  // whole pixels, so the tiles and the radar image line up exactly
  top = floor(cy - RADAR_H / 2.0);
}

void uiRadarBBox(float lat, float lon, int z, double& minX, double& minY, double& maxX, double& maxY) {
  const double o = M_PI * 6378137.0, res = 2 * o / (256.0 * (1 << z));  // EPSG:3857 metres per pixel at zoom z
  double left, top;
  uiRadarOrigin(lat, lon, z, left, top);
  minX = left * res - o;  maxX = (left + RADAR_W) * res - o;
  maxY = o - top * res;   minY = o - (top + RADAR_H) * res;
}

// Draws every 256 px tile the map covers into dst, over what's there. JPEG or PNG, by the first bytes.
static bool radarTiles(LGFX_Sprite& dst, float lat, float lon, int z, RadarTileFn tile) {
  double left, top;
  uiRadarOrigin(lat, lon, z, left, top);
  const int n = 1 << z;
  bool all = true;
  for (int ty = int(floor(top / 256)); ty * 256.0 < top + RADAR_H; ty++)
    for (int tx = int(floor(left / 256)); tx * 256.0 < left + RADAR_W; tx++) {
      if (ty < 0 || ty >= n) continue;  // beyond the poles: nothing to fetch
      const uint8_t* img;
      size_t len;
      if (!tile(z, (tx % n + n) % n, ty, img, len) || len < 4) { all = false; continue; }
      const int x = int(tx * 256 - left), y = int(ty * 256 - top);
      all &= img[0] == 0xFF && img[1] == 0xD8 ? dst.drawJpg(img, len, x, y) : dst.drawPng(img, len, x, y);
    }
  return all;
}

bool uiRadarLayer(LGFX_Sprite& dst, float lat, float lon, int z, RadarTileFn tile, uint32_t fill) {
  if (!sizeSprite(dst, RADAR_W, RADAR_H)) return false;
  dst.fillScreen(fill);
  return radarTiles(dst, lat, lon, z, tile);
}

bool uiRadarCompose(LGFX_Sprite& dst, const LGFX_Sprite& base, const uint8_t* png, size_t len, const LGFX_Sprite* labels) {
  if (!sizeSprite(dst, base.width(), base.height())) return false;
  memcpy(dst.getBuffer(), const_cast<LGFX_Sprite&>(base).getBuffer(), size_t(base.width()) * base.height() * 2);
  bool ok = dst.drawPng(png, len, 0, 0);
  // Labels' anti-aliased edges were blended toward black, so they keep a thin dark halo over the radar.
  if (labels) const_cast<LGFX_Sprite*>(labels)->pushSprite(&dst, 0, 0, RADAR_CLEAR);
  return ok;
}

// The latest frame of the loop, and the location sheet's state.
static LGFX_Sprite radarPic;
static Weather* wx = nullptr;  // the latest weather; on the heap, so its ~5 KB lands in PSRAM
static bool radarHave = false;  // radarPic holds a frame for the current location and zoom
static time_t radarT = 0;
static int radarFrame = 0, radarFrames = 0;
static char radarEntry[6] = "", radarAsk[6] = "";
static bool radarAsked = false;
static enum : uint8_t { RL_IDLE, RL_LOOKING, RL_NOTFOUND } radarLookup = RL_IDLE;

bool uiRadarWanted() { return !home && app == FN_RADAR && !radarSheet; }
bool uiRadarApp() { return !home && app == FN_RADAR; }

bool uiRadarFrame(const LGFX_Sprite& pic, time_t t, int frame, int frames) {
  if (!sizeSprite(radarPic, pic.width(), pic.height())) return false;
  memcpy(radarPic.getBuffer(), const_cast<LGFX_Sprite&>(pic).getBuffer(), size_t(pic.width()) * pic.height() * 2);
  radarHave = true;
  radarT = t;
  radarFrame = frame;
  radarFrames = frames;
  return uiRadarWanted();
}

const char* uiTakeRadarZip() {
  if (!radarAsked) return nullptr;
  radarAsked = false;
  return radarAsk;
}

void uiRadarPlace(bool ok, const char* zip, float lat, float lon, const char* place) {
  if (!ok) { radarLookup = RL_NOTFOUND; return; }
  snprintf(settings.radarZip, sizeof settings.radarZip, "%s", zip);
  snprintf(settings.radarPlace, sizeof settings.radarPlace, "%s", place);
  settings.radarLat = lat;
  settings.radarLon = lon;
  settingsChanged = true;
  radarLookup = RL_IDLE;
  radarSheet = false;  // back to the map, which reloads for the new place
  radarAlert = -1;
  if (wx) *wx = Weather();  // the old place's weather would mislead until the new one arrives
  radarHave = false;
  radarEntry[0] = 0;
}

// RadarOp: 0..N_RADAR_ZOOMS-1 pick a zoom; R_DIGIT + 0..9 types a digit.
enum RadarOp : uint8_t { R_SHEET = 8, R_BACK, R_DEL, R_SAVE, R_ALERT, R_ALERT_NEXT, R_DIGIT = 16 };
static void radarOp(uint8_t op) {
  if (op < N_RADAR_ZOOMS) {
    if (settings.radarZoom != op) { settings.radarZoom = op; settingsChanged = true; radarHave = false; }
    return;
  }
  size_t n = strlen(radarEntry);
  switch (op) {
    case R_SHEET: radarSheet = true; radarEntry[0] = 0; radarLookup = RL_IDLE; return;
    case R_BACK: radarSheet = false; radarAlert = -1; return;
    case R_ALERT: radarAlert = wx && wx->nAlerts ? 0 : -1; return;
    case R_ALERT_NEXT: if (wx && wx->nAlerts) radarAlert = (radarAlert + 1) % wx->nAlerts; return;
    case R_DEL: if (n) radarEntry[n - 1] = 0; radarLookup = RL_IDLE; return;
    case R_SAVE:
      if (n == 5 && radarLookup != RL_LOOKING) {
        memcpy(radarAsk, radarEntry, sizeof radarAsk);
        radarAsked = true;
        radarLookup = RL_LOOKING;
      }
      return;
    default:
      if (op >= R_DIGIT && op < R_DIGIT + 10 && n < 5) { radarEntry[n] = char('0' + op - R_DIGIT); radarEntry[n + 1] = 0; }
      radarLookup = RL_IDLE;
  }
}

// NWS reflectivity colours, light to heavy (5 to 70 dBZ in steps of 5), for the legend.
static const uint32_t DBZ[] = {0x04E9E7, 0x019FF4, 0x0300F4, 0x02FD02, 0x01C501, 0x008E00, 0xFDF802,
                               0xE5BC00, 0xFD9500, 0xFD0000, 0xD40000, 0xBC0000, 0xF800FD, 0x9854C6};

// ---- local weather (api.weather.gov, fetched by radar.cpp while the radar is open) ----
void uiRadarWeather(const Weather& w) {
  if (!wx) wx = new Weather;
  *wx = w;
  if (radarAlert >= wx->nAlerts) radarAlert = wx->nAlerts ? 0 : -1;  // the shown alert ended
}

// NWS's own scheme, roughly: warnings red, watches amber, advisories and statements cyan.
static uint32_t alertColor(const WxAlert& a) {
  return strstr(a.event, "Warning") ? C_RED : strstr(a.event, "Watch") ? C_AMBER : C_CYAN;
}

// "until 9:45 PM", or "until Sat 6:00 AM" if it isn't today.
static void fmtUntil(char* buf, size_t n, time_t ends, const tm* clock) {
  if (!ends) { snprintf(buf, n, "until further notice"); return; }
  tm t = *localtime(&ends);
  char hm[16];
  const char* ampm = fmtClock(hm, sizeof hm, &t);
  char day[8] = "";
  if (!clock || t.tm_yday != clock->tm_yday) strftime(day, sizeof day, "%a ", &t);
  snprintf(buf, n, "until %s%s%s%s", day, hm, ampm ? " " : "", ampm ? ampm : "");
}

// Word-wraps s into w pixels from (x, y), stopping above maxY; paragraphs at '\n'.
// Returns the y below the last line drawn.
// rest: when given, text that didn't fit is left for the caller (e.g. a second column) instead of ending in "...".
static int wrapText(int x, int y, int w, int maxY, const char* s, const lgfx::IFont* f, uint32_t col, int lineH,
                    int paraGap, const char** rest = nullptr) {
  if (rest) *rest = nullptr;
  spr.setFont(f);
  char line[200];
  while (*s && y + lineH <= maxY) {
    const char* end = strchr(s, '\n');
    const size_t plen = end ? size_t(end - s) : strlen(s);
    size_t i = 0;
    while (i < plen && y + lineH <= maxY) {
      while (i < plen && s[i] == ' ') i++;
      size_t fit = 0;  // the longest run of whole words, from s + i, that fits
      for (size_t k = 0;;) {
        while (i + k < plen && s[i + k] == ' ') k++;
        size_t e = k;
        while (i + e < plen && s[i + e] != ' ') e++;
        if (e == k) break;
        if (e >= sizeof line) {  // longer than the buffer: stop at a whole character
          e = sizeof line - 1;
          while (e > k && (s[i + e] & 0xC0) == 0x80) e--;
        }
        memcpy(line, s + i, e);
        line[e] = 0;
        if (spr.textWidth(line) > w && fit) break;
        fit = k = e;
        if (spr.textWidth(line) > w) break;  // one word wider than the line: it gets the line to itself
      }
      if (fit) {  // a word wider than the line (Japanese has no spaces): break it between characters
        memcpy(line, s + i, fit);
        line[fit] = 0;
        while (spr.textWidth(line) > w) {
          size_t c = fit;
          do c--; while (c > 0 && (line[c] & 0xC0) == 0x80);
          if (!c) break;
          line[fit = c] = 0;
        }
      }
      if (!fit) break;
      if (!rest && y + 2 * lineH > maxY && (i + fit < plen || (end && end[1]))) {  // the last line, and there's more: "..."
        snprintf(line, sizeof line, "%.*s", int(std::min(plen - i, sizeof line - 1)), s + i);
        textFit(x, y, line, w, f, col);
        return y + lineH;
      }
      memcpy(line, s + i, fit);
      line[fit] = 0;
      text(x, y, line, f, col);
      y += lineH;
      i += fit;
    }
    if (i < plen) { if (rest) *rest = s + i; return y; }  // out of room mid-paragraph
    y += paraGap;
    s += plen + (end ? 1 : 0);
  }
  if (rest && *s) *rest = s;
  return y - paraGap;
}

// An icon for an NWS description ("Mostly Cloudy", "Chance Showers And Thunderstorms"), and its colour.
static bool has(const char* s, const char* word) {  // case-insensitive; word in lower case
  for (; *s; s++) {
    const char *a = s, *b = word;
    while (*a && *b && tolower((unsigned char)*a) == *b) a++, b++;
    if (!*b) return true;
  }
  return false;
}
static const char* wxIcon(const char* sky, bool night, uint32_t& col) {
  const uint32_t sun = mix(C_AMBER, C_TEXT, 0.55f), moon = mix(C_VIOLET, C_TEXT, 0.4f);
  col = C_CYAN;
  if (has(sky, "thunder")) { col = C_VIOLET; return ICON_THUNDERSTORM_FILL; }
  if (has(sky, "snow") || has(sky, "flurr") || has(sky, "sleet") || has(sky, "ice")) return ICON_WEATHER_SNOWY_FILL;
  if (has(sky, "rain") || has(sky, "shower") || has(sky, "drizzle")) return ICON_RAINY_FILL;
  col = C_MUTED;
  if (has(sky, "fog") || has(sky, "haze") || has(sky, "smoke") || has(sky, "mist")) return ICON_FOGGY_FILL;
  if (has(sky, "partly") || has(sky, "mostly sunny") || has(sky, "mostly clear")) {
    col = night ? moon : sun;
    return night ? ICON_PARTLY_CLOUDY_NIGHT_FILL : ICON_PARTLY_CLOUDY_DAY_FILL;
  }
  if (has(sky, "cloud") || has(sky, "overcast")) return ICON_CLOUD_FILL;
  col = night ? moon : sun;
  return night ? ICON_CLEAR_NIGHT_FILL : ICON_SUNNY_FILL;
}

// Top left, under the place: now (icon, temperature, sky, wind), then the next two forecast periods, then "no alerts"
// if that's the case. A dark card floating on the map.
static void radarWeatherCard(int x, int y, const tm* clock) {
  if (!wx || !wx->have) return;
  const bool quiet = wx->alertsKnown && !wx->nAlerts;
  const int w = 300, h = 140 + wx->nPeriods * 32 + (quiet ? 30 : 0) + 10;
  spr.fillSmoothRoundRect(x, y, w, h, 20, C_BG);
  char buf[96];
  uint32_t ic;
  const char* icon = wxIcon(wx->sky, clock && (clock->tm_hour < 6 || clock->tm_hour >= 19), ic);
  text(x + 40, y + 42, icon, I_M, ic, middle_center);
  if (!isnan(wx->tempF)) snprintf(buf, sizeof buf, "%.0f" DEG, wx->tempF);
  else snprintf(buf, sizeof buf, "--");
  text(x + 76, y + 42, buf, F_HUGE, C_TEXT, middle_left);
  textFit(x + 20, y + 88, *wx->sky ? wx->sky : "No report", w - 40, F_BODY, C_TEXT, middle_left);
  int n = 0;
  if (!isnan(wx->windMph)) n += snprintf(buf, sizeof buf, wx->windMph < 1 ? "Calm" : "%s %.0f mph", wx->windDir, wx->windMph);
  if (!isnan(wx->humidity)) snprintf(buf + n, sizeof buf - n, "%s%.0f%% humidity", n ? "  /  " : "", wx->humidity);
  if (n || !isnan(wx->humidity)) textFit(x + 20, y + 114, buf, w - 40, F_SMALL, C_MUTED, middle_left);
  spr.drawFastHLine(x + 20, y + 134, w - 40, C_GRID);
  int ly = y + 156;
  for (int i = 0; i < wx->nPeriods; i++, ly += 32) {
    const auto& p = wx->periods[i];
    const char* pi = wxIcon(p.brief, has(p.name, "night"), ic);
    text(x + 34, ly, pi, I_S, ic, middle_center);
    if (p.pop >= 20) snprintf(buf, sizeof buf, "%s  /  %d%% rain", p.name, p.pop);
    else snprintf(buf, sizeof buf, "%s", p.name);
    textFit(x + 58, ly, buf, w - 58 - 70, F_SMALL, C_MUTED, middle_left);
    snprintf(buf, sizeof buf, "%d" DEG, p.temp);
    text(x + w - 20, ly, buf, F_BODYB, C_TEXT, middle_right);
  }
  if (quiet) {
    dot(x + 34, ly, C_GREEN);
    text(x + 58, ly, "No NWS alerts", F_SMALL, C_MUTED, middle_left);
  }
}

// Top centre, between the place and the zoom control: the most severe alert; it opens the alert sheet.
static void radarAlertBanner(int x0, int x1, int y, const tm* clock) {
  if (!wx || !wx->nAlerts || x1 - x0 < 160) return;
  const WxAlert& a = wx->alerts[0];
  char until[40], buf[128], more[8] = "";
  fmtUntil(until, sizeof until, a.ends, clock);
  snprintf(buf, sizeof buf, "%s  %s", a.event, until);
  const int h = 44;
  spr.fillSmoothRoundRect(x0, y, x1 - x0, h, h / 2, alertColor(a));
  text(x0 + 26, y + h / 2, ICON_WARNING_FILL, I_S, C_BG, middle_center);
  int mw = 0;  // "+1": the count of further alerts, pinned at the end so a long name can't push it off
  if (wx->nAlerts > 1) {
    snprintf(more, sizeof more, "+%d", wx->nAlerts - 1);
    spr.setFont(F_BODYB);
    mw = spr.textWidth(more) + 18;
    spr.drawRoundRect(x1 - 38 - mw, y + 10, mw, h - 20, (h - 20) / 2, C_BG);
    text(x1 - 38 - mw / 2, y + h / 2, more, F_BODYB, C_BG, middle_center);
  }
  const int tw = x1 - x0 - 46 - 40 - (mw ? mw + 8 : 0);
  spr.setFont(F_BODYB);
  if (spr.textWidth(buf) > tw) snprintf(buf, sizeof buf, "%s", a.event);  // no half a time: it's on the sheet
  textFit(x0 + 46, y + h / 2, buf, tw, F_BODYB, C_BG, middle_left);  // dark on the alert colour
  text(x1 - 22, y + h / 2, ICON_CHEVRON_RIGHT, I_S, C_BG, middle_center);
  hit(x0 - 6, y - 6, x1 - x0 + 12, h + 12, ACT_RADAR, R_ALERT);
}

// The map fills the screen above a strip with the loop's time, frames and legend; the place, weather, alert and zoom
// float on it.
static void drawRadarMap(const Status& s, const tm* clock) {
  char buf[32];
  if (radarHave) {
    radarPic.pushSprite(&spr, 0, 0);
    const int hx = W / 2, hy = RADAR_H / 2;  // the location itself
    spr.fillSmoothCircle(hx, hy, 10, C_BG);
    spr.fillSmoothCircle(hx, hy, 7, C_TEXT);
    for (int y = 0; y < 64; y++) spr.fillRectAlpha(0, y, W, 1, 235 - y * 235 / 64, C_BG);  // the status bar fades in
  } else {
    background(C_GREEN);
    text(W / 2, RADAR_H / 2, s.wifi ? "Loading radar..." : "Waiting for Wi-Fi...", F_STAT, C_DIM, middle_center);
  }
  statusBar(clock, s.wifi, ICON_RADAR, C_GREEN, "Weather Radar", "", 0, s.radar, "OFFLINE  /  no radar from NOAA yet");

  // Top left: the place, which opens the location sheet.
  spr.setFont(F_BODYB);
  const int cw = spr.textWidth(settings.radarPlace) + 92, ch = 44, cx = M, cy = TOP + 2;
  spr.fillSmoothRoundRect(cx, cy, cw, ch, ch / 2, C_BG);
  text(cx + 26, cy + ch / 2, ICON_LOCATION_ON_FILL, I_S, C_GREEN, middle_center);
  text(cx + 46, cy + ch / 2, settings.radarPlace, F_BODYB, C_TEXT, middle_left);
  text(cx + cw - 22, cy + ch / 2, ICON_CHEVRON_RIGHT, I_S, C_MUTED, middle_center);
  hit(cx - 6, cy - 6, cw + 12, ch + 12, ACT_RADAR, R_SHEET);

  // Top right: zoom. Then the weather under the place and the most severe alert between them.
  static const char* const zoomL[N_RADAR_ZOOMS] = {"Local", "Regional", "Wide"};
  const int zw = 96, zx = W - M;
  segmented(zx, cy + ch / 2, zoomL, N_RADAR_ZOOMS, settings.radarZoom, 0, zw, ACT_RADAR, C_BG, C_GREEN);
  radarWeatherCard(cx, cy + ch + 12, clock);
  radarAlertBanner(cx + cw + 14, zx - N_RADAR_ZOOMS * zw - 6 - 14, cy, clock);

  // The strip: the frame's time, latest or not, the loop's frames, the legend and credits.
  spr.fillRect(0, RADAR_H, W, H - RADAR_H, mix(C_BG, 0x000000, 0.65f));
  const int sy = RADAR_H + (H - RADAR_H) / 2;
  if (radarHave && radarT) {
    tm t = *localtime(&radarT);
    const char* ampm = fmtClock(buf, sizeof buf, &t);
    if (ampm) { size_t n = strlen(buf); snprintf(buf + n, sizeof buf - n, " %s", ampm); }
    text(20, sy, buf, F_TITLE, C_TEXT, middle_left);
  }
  if (radarHave) {
    const bool latest = radarFrame == radarFrames - 1;
    pill(240, sy, latest ? "latest" : "past hour", latest ? C_GREEN : C_MUTED);
    const int fx = 258, fw = W - 20 - 328 - fx, each = fw / std::max(radarFrames, 1);
    for (int i = 0; i < radarFrames; i++)
      spr.fillSmoothRoundRect(fx + i * each, sy - 4, each - 6, 8, 4, i == radarFrame ? C_TEXT : i < radarFrame ? C_DIM : C_TRACK);
  }
  const int nd = sizeof DBZ / sizeof *DBZ, lw = 308, lx = W - 20 - lw, seg = lw / nd;
  for (int i = 0; i < nd; i++) spr.fillRect(lx + i * seg, sy - 14, seg, 8, DBZ[i]);
  text(lx, sy + 4, "light", F_SMALL, C_DIM);
  text(lx + lw / 2, sy + 4, "NOAA  /  Esri, OSM", F_SMALL, C_DIM, top_center);
  text(lx + nd * seg, sy + 4, "heavy", F_SMALL, C_DIM, top_right);
}

// The location sheet: type a US ZIP code on the keypad; radar.cpp looks it up and the map moves there.
static void drawRadarSheet(const Status& s, const tm* clock) {
  background(C_GREEN);
  statusBar(clock, s.wifi, "", C_GREEN, "Radar location", "US ZIP code  /  swipe or tap the arrow to go back", 0, true,
            nullptr, true);
  hit(0, 0, 260, SB_H, ACT_RADAR, R_BACK);  // over the status bar's own back target, which only settings handle
  char buf[48];

  const int lw = 470, lx = M, ix = lx + 28;
  card(lx, TOP, lw, BOTTOM - TOP);
  text(ix, TOP + 28, "NOW SHOWING", F_SMALL, C_DIM);
  text(ix + 14, TOP + 82, ICON_LOCATION_ON_FILL, I_S, C_GREEN, middle_center);
  textFit(ix + 38, TOP + 82, settings.radarPlace, lw - 66 - 38, F_BIG, C_TEXT, middle_left);
  snprintf(buf, sizeof buf, "ZIP %s", settings.radarZip);
  text(ix + 38, TOP + 112, buf, F_BODY, C_MUTED);
  spr.drawFastHLine(ix, TOP + 156, lw - 56, C_GRID);

  text(ix, TOP + 182, "NEW ZIP CODE", F_SMALL, C_DIM);
  const int bw = 70, bh = 88, gap = 12, by = TOP + 214;
  const size_t n = strlen(radarEntry);
  for (int i = 0; i < 5; i++) {
    const int bx = ix + i * (bw + gap);
    if (i == int(n)) spr.fillSmoothRoundRect(bx - 2, by - 2, bw + 4, bh + 4, 16, C_GREEN);  // the cursor
    spr.fillSmoothRoundRect(bx, by, bw, bh, 14, field());
    if (i < int(n)) { char d[2] = {radarEntry[i], 0}; text(bx + bw / 2, by + bh / 2, d, F_HUGE, C_TEXT, middle_center); }
  }
  const char* msg = radarLookup == RL_LOOKING  ? "Looking it up..."
                  : radarLookup == RL_NOTFOUND ? "No US location found for that ZIP"
                  : n == 5                     ? "Tap the check to show this ZIP"
                                               : "Type a 5-digit US ZIP code";
  uint32_t mc = radarLookup == RL_NOTFOUND ? C_RED : radarLookup == RL_LOOKING ? C_AMBER : C_MUTED;
  text(lx + lw / 2, by + bh + 40, msg, F_BODY, mc, middle_center);

  // Keypad: 1-9, then delete, 0, save.
  const int kx0 = lx + lw + 12, kw = (M + BODY_W - kx0 - 2 * 12) / 3, kh = (BOTTOM - TOP - 3 * 12) / 4;
  static const char* const keys[12] = {"1", "2", "3", "4", "5", "6", "7", "8", "9", "", "0", ""};
  const bool ready = n == 5 && radarLookup != RL_LOOKING;
  for (int i = 0; i < 12; i++) {
    const int kx = kx0 + i % 3 * (kw + 12), ky = TOP + i / 3 * (kh + 12);
    const uint8_t op = i == 9 ? R_DEL : i == 11 ? R_SAVE : uint8_t(R_DIGIT + (i == 10 ? 0 : i + 1));
    spr.fillSmoothRoundRect(kx, ky, kw, kh, 20, op == R_SAVE && ready ? mix(C_GREEN, C_CARD, 0.3f) : C_CARD);
    if (op == R_DEL) text(kx + kw / 2, ky + kh / 2, ICON_BACKSPACE_FILL, I_M, C_MUTED, middle_center);
    else if (op == R_SAVE) text(kx + kw / 2, ky + kh / 2, ICON_CHECK, I_M, ready ? C_TEXT : C_DIM, middle_center);
    else text(kx + kw / 2, ky + kh / 2, keys[i], F_BIG, C_TEXT, middle_center);
    hit(kx, ky, kw, kh, ACT_RADAR, op);
  }
}

// The alert sheet: one alert's full text in two columns under a band in its colour; a tap shows the next.
static void drawRadarAlert(const Status& s, const tm* clock) {
  if (!wx || radarAlert < 0 || radarAlert >= wx->nAlerts) { radarAlert = -1; return; }
  const WxAlert& a = wx->alerts[radarAlert];
  const uint32_t col = alertColor(a);
  char sub[80];
  if (wx->nAlerts > 1)
    snprintf(sub, sizeof sub, "%d of %d  /  tap for the next  /  swipe or the arrow to go back", radarAlert + 1, wx->nAlerts);
  else
    snprintf(sub, sizeof sub, "%s  /  swipe or tap the arrow to go back", settings.radarPlace);
  background(col, 0.2f);
  statusBar(clock, s.wifi, "", col, "Weather alert", sub, 0, true, nullptr, true);

  spr.fillSmoothRoundRect(M, TOP, BODY_W, 120, 20, col);
  text(M + 64, TOP + 60, ICON_WARNING_FILL, I_L, C_BG, middle_center);
  textFit(M + 124, TOP + 44, a.event, BODY_W - 148, F_BIG, C_BG, middle_left);
  char until[40], buf[96];
  fmtUntil(until, sizeof until, a.ends, clock);
  snprintf(buf, sizeof buf, "%s  /  %s  /  National Weather Service", a.severity, until);
  textFit(M + 124, TOP + 88, buf, BODY_W - 148, F_BODYB, C_BG, middle_left);

  const int ty = TOP + 136, th = BOTTOM - ty, colW = (BODY_W - 64 - 40) / 2;
  card(M, ty, BODY_W, th);
  const char* rest = nullptr;
  wrapText(M + 32, ty + 24, colW, ty + th - 16, a.text, F_BODY, C_TEXT, 27, 10, &rest);
  if (rest) wrapText(M + 32 + colW + 40, ty + 24, colW, ty + th - 16, rest, F_BODY, C_TEXT, 27, 10);
  if (wx->nAlerts > 1) hit(M, TOP, BODY_W, BOTTOM - TOP, ACT_RADAR, R_ALERT_NEXT);
  hit(0, 0, 260, SB_H, ACT_RADAR, R_BACK);  // over the status bar's own back target, which only settings handle
}

// ---------- Spotify app ----------
// Album art on the left, the track and its controls on the right. spotify.cpp polls the Web API and applies each
// control to its copy of the state at once, so a tap shows before Spotify confirms it.
static Spotify sp;
static LGFX_Sprite spArt;
static bool spArtHave = false;
static LGFX_Sprite spThumb;  // the art at 72 px, for the launcher tile
static bool spThumbHave = false;
static uint32_t spTint = 0x283240;  // the album's colour for the background (RGB888, full strength)
static int8_t spCmd = -1, spFlash = -1;  // flash: the tapped control is drawn highlighted for one frame
static int spArg = 0;
// Screen-only controls (never sent as such): the volume slider, the sheets; library items and devices by index.
enum : uint8_t { SPU_VOLUME_OPEN = 100, SPU_VOLUME_CLOSE, SPU_LIBRARY, SPU_DEVICES, SPU_SHEET_CLOSE, SPU_ITEM = 120,
                 SPU_DEVICE = 140 };
static SpotifyLibrary spLib;
static SpotifyDevices spDevs;
static LGFX_Sprite spCovers[SPOTIFY_ITEMS];
static bool spCoverHave[SPOTIFY_ITEMS];

bool uiSpotifyWanted() { return !home && app == FN_SPOTIFY; }
bool uiSpotifyLibraryOpen() { return uiSpotifyWanted() && spSheet == SPU_LIBRARY; }
bool uiSpotifyDevicesOpen() { return uiSpotifyWanted() && spSheet == SPU_DEVICES; }
void uiSpotifyLibrary(const SpotifyLibrary& lib) {
  spLib = lib;
  for (bool& h : spCoverHave) h = false;  // a new list: its covers follow
}
void uiSpotifyDevices(const SpotifyDevices& devs) { spDevs = devs; }
void uiSpotifyCover(int i, const LGFX_Sprite& c) {
  if (i < 0 || i >= SPOTIFY_ITEMS || c.width() != SPOTIFY_COVER || !sizeSprite(spCovers[i], SPOTIFY_COVER, SPOTIFY_COVER)) return;
  memcpy(spCovers[i].getBuffer(), const_cast<LGFX_Sprite&>(c).getBuffer(), size_t(SPOTIFY_COVER) * SPOTIFY_COVER * 2);
  spCoverHave[i] = true;
}
static bool spSetUp() { return *SPOTIFY_REFRESH || sp.active; }  // or the preview's sample state
void uiSpotify(const Spotify& s) {
  if (strcmp(s.id, sp.id)) spVolume = false;  // a new track: back to the buttons
  sp = s;
}

// Called by the Spotify task only (the scratch sprite is its own). Decodes at full size, then scales with
// anti-aliasing: drawJpg's own scaling is nearest-neighbour (the camera's screen-door grid). tint: the art's
// dominant colour. A 32 x 32 grid of samples goes into 12 hue bins, each weighted by its saturation; the heaviest
// bin's average wins. Averaging all of them mixed e.g. purple and orange into brown.
static LGFX_Sprite spFull;  // the Spotify task's scratch: a JPEG at full size
static bool squareDecode(LGFX_Sprite& dst, const uint8_t* jpg, size_t len, int size, int& jw, int& jh) {
  if (!jpegSize(jpg, len, jw, jh) || !sizeSprite(spFull, jw, jh) || !spFull.drawJpg(jpg, len, 0, 0) || !sizeSprite(dst, size, size))
    return false;
  float sc = std::max(float(size) / jw, float(size) / jh);
  dst.fillScreen(0);
  spFull.pushRotateZoomWithAA(&dst, size / 2.0f, size / 2.0f, 0, sc, sc);
  return true;
}
bool uiSpotifyCoverDecode(LGFX_Sprite& dst, const uint8_t* jpg, size_t len) {
  int jw, jh;
  return squareDecode(dst, jpg, len, SPOTIFY_COVER, jw, jh);
}

bool uiSpotifyDecode(LGFX_Sprite& dst, const uint8_t* jpg, size_t len, uint32_t& tint) {
  int jw, jh;
  if (!squareDecode(dst, jpg, len, SPOTIFY_ART, jw, jh)) return false;
  LGFX_Sprite& full = spFull;
  struct { float r, g, b, w; } bin[13] = {};  // 12 hues, then the greys
  for (int gy = 0; gy < 32; gy++)
    for (int gx = 0; gx < 32; gx++) {
      auto c = full.readPixelRGB(gx * jw / 32 + jw / 64, gy * jh / 32 + jh / 64);
      const int mx = std::max({c.r, c.g, c.b}), mn = std::min({c.r, c.g, c.b}), sat = mx - mn;
      int k = 12;
      if (sat > 24) {
        float h = mx == c.r ? float(c.g - c.b) / sat : mx == c.g ? 2 + float(c.b - c.r) / sat : 4 + float(c.r - c.g) / sat;
        k = int((h < 0 ? h + 6 : h) * 2) % 12;
      }
      const float w = 1 + sat;
      bin[k].r += c.r * w; bin[k].g += c.g * w; bin[k].b += c.b * w; bin[k].w += w;
    }
  int best = 12;
  for (int k = 0; k < 12; k++) if (bin[k].w > bin[best].w) best = k;
  const auto& m = bin[best];
  tint = m.w ? uint32_t(m.r / m.w) << 16 | uint32_t(m.g / m.w) << 8 | uint32_t(m.b / m.w) : 0x283240;
  return true;
}

void uiSpotifyArt(const LGFX_Sprite& art, uint32_t tint) {
  spArtHave = art.width() == SPOTIFY_ART && sizeSprite(spArt, SPOTIFY_ART, SPOTIFY_ART);
  if (spArtHave) memcpy(spArt.getBuffer(), const_cast<LGFX_Sprite&>(art).getBuffer(), size_t(SPOTIFY_ART) * SPOTIFY_ART * 2);
  spTint = spArtHave ? tint : 0x283240;
  spThumbHave = spArtHave && sizeSprite(spThumb, 72, 72);
  if (spThumbHave) spArt.pushRotateZoomWithAA(&spThumb, 36, 36, 0, 72.0f / SPOTIFY_ART, 72.0f / SPOTIFY_ART);
}

bool uiTakeSpotify(uint8_t& cmd, int& arg) {
  if (spCmd < 0) return false;
  cmd = spCmd;
  arg = spArg;
  spCmd = -1;
  return true;
}

static void spotifyOp(uint8_t cmd, float at) {
  if (cmd == SPU_VOLUME_OPEN || cmd == SPU_VOLUME_CLOSE) { spVolume = cmd == SPU_VOLUME_OPEN; return; }
  if (cmd == SPU_LIBRARY || cmd == SPU_DEVICES) { spSheet = cmd; return; }
  if (cmd == SPU_SHEET_CLOSE) { spSheet = 0; return; }
  int arg = 0;
  if (cmd >= SPU_DEVICE) { arg = cmd - SPU_DEVICE; cmd = SP_DEVICE; spSheet = 0; }
  else if (cmd >= SPU_ITEM) { arg = cmd - SPU_ITEM; cmd = SP_CONTEXT; spSheet = 0; }
  switch (cmd) {
    case SP_PLAY: case SP_PAUSE: cmd = sp.playing ? SP_PAUSE : SP_PLAY; break;
    case SP_SEEK: arg = int(at * sp.durationMs); break;
    case SP_VOLUME: arg = int(at * 100 + 0.5f); break;
    case SP_SHUFFLE: arg = !sp.shuffle; break;
    case SP_REPEAT: arg = (sp.repeat + 1) % 3; break;
    case SP_LIKE: arg = !sp.liked; break;
  }
  spCmd = spFlash = cmd;
  spArg = arg;
}

static void appIcon(int x, int y, const char* icon, uint32_t c) { text(x + 32, y + 32, icon, I_L, c, middle_center); }  // 64 px square

static void fmtMs(char* buf, size_t n, uint32_t ms) { snprintf(buf, n, "%u:%02u", unsigned(ms / 60000), unsigned(ms / 1000 % 60)); }

// Laid out like Spotify's Car Thing: no header or cards; the album's colour as a dark gradient behind everything,
// big art beside a big title, a thin full-width progress bar, and a strip of large buttons along the bottom.
constexpr int SP_ART_X = 40, SP_ART_Y = 36, SP_BAR_Y = 500, SP_STRIP_Y = 508;

// ---- the library and devices sheets ----
// Laid out like the Car Thing's browse screens: black behind, a row of tabs across the top (the current one white
// over a green underline), the green note at the right back to the player, then big covers or a list in big type.
static void spotifyNav(uint8_t sel) {
  spr.fillScreen(mix(C_BG, 0x000000, 0.55f));
  const struct { const char* icon; const char* label; uint8_t op; } tabs[2] = {
      {ICON_LIBRARY_MUSIC_FILL, "Your Library", SPU_LIBRARY}, {ICON_SPEAKER_GROUP_FILL, "Devices", SPU_DEVICES}};
  int x = 32;
  for (const auto& t : tabs) {
    const bool on = t.op == sel;
    const uint32_t c = on ? C_TEXT : C_DIM;
    text(x + 14, 34, t.icon, I_S, c, middle_center);
    text(x + 38, 34, t.label, F_TITLE, c, middle_left);
    const int w = 38 + spr.textWidth(t.label);
    if (on) spr.fillRect(x, 56, w, 4, C_GREEN);
    hit(x - 12, 0, w + 24, 68, ACT_SPOTIFY, t.op);
    x += w + 40;
  }
  text(W - 44, 34, ICON_MUSIC_NOTE, I_M, C_GREEN, middle_center);  // back to the player
  hit(W - 100, 0, 100, 68, ACT_SPOTIFY, SPU_SHEET_CLOSE);
}

static void drawSpotifyLibrary(const Status& s) {
  spotifyNav(SPU_LIBRARY);
  if (!spLib.known) {
    text(W / 2, H / 2, s.wifi ? "Loading your library..." : "Waiting for Wi-Fi...", F_STAT, C_DIM, middle_center);
    return;
  }
  const uint32_t under = mix(C_BG, 0x000000, 0.55f);
  const int x0 = 32, gap = (W - 2 * x0 - 6 * SPOTIFY_COVER) / 5;
  for (int row = 0; row < 2; row++) {
    const int y0 = 80 + row * 246, n = row ? spLib.nLists : spLib.nRecent, base = row ? SPOTIFY_RECENT : 0;
    text(x0, y0, row ? "Your playlists" : "Jump back in", F_BODYB, C_MUTED);
    if (!n) {
      const char* e = spLib.error[row];
      text(x0, y0 + 40, *e ? e : row ? "No playlists yet" : "Nothing played recently", F_BODY, *e ? C_AMBER : C_DIM);
      if (*e && (strstr(e, "401") || strstr(e, "403")))
        text(x0, y0 + 70, "Re-run tools/spotify_auth.py: the login needs the library permissions", F_BODY, C_MUTED);
    }
    for (int k = 0; k < n; k++) {
      const int i = base + k, x = x0 + k * (SPOTIFY_COVER + gap), y = y0 + 28;
      if (spCoverHave[i]) {
        spCovers[i].pushSprite(&spr, x, y);
        roundCorners(x, y, SPOTIFY_COVER, SPOTIFY_COVER, 8, under);
      } else {
        spr.fillSmoothRoundRect(x, y, SPOTIFY_COVER, SPOTIFY_COVER, 8, C_CARD);
        const bool liked = !strcmp(spLib.item[i].name, "Liked Songs");
        text(x + SPOTIFY_COVER / 2, y + SPOTIFY_COVER / 2, liked ? ICON_FAVORITE_FILL : ICON_MUSIC_NOTE, I_M,
             liked ? C_GREEN : C_DIM, middle_center);
      }
      textFit(x, y + SPOTIFY_COVER + 12, spLib.item[i].name, SPOTIFY_COVER, F_BODYB, C_TEXT);
      textFit(x, y + SPOTIFY_COVER + 36, spLib.item[i].sub, SPOTIFY_COVER, F_BODY, C_DIM);
      hit(x - gap / 2, y - 6, SPOTIFY_COVER + gap, SPOTIFY_COVER + 64, ACT_SPOTIFY, SPU_ITEM + i);
    }
  }
}

static void drawSpotifyDevices(const Status& s) {
  spotifyNav(SPU_DEVICES);
  if (!spDevs.known || !spDevs.n) {
    text(W / 2, H / 2, !spDevs.known ? "Looking for devices..." : "No devices: open Spotify on a phone, PC or speaker",
         F_STAT, C_DIM, middle_center);
    return;
  }
  const int x0 = 32, top = 92, rh = std::min(104, (H - top - 8) / spDevs.n);
  for (int i = 0; i < spDevs.n; i++) {
    const SpotifyDevice& d = spDevs.d[i];
    const int y = top + i * rh, cy = y + rh / 2, ts = std::min(80, rh - 16);
    const char* icon = !strcmp(d.type, "Computer") ? ICON_COMPUTER_FILL : !strcmp(d.type, "Smartphone") ? ICON_SMARTPHONE_FILL
                     : !strcmp(d.type, "Speaker") ? ICON_SPEAKER_FILL : !strcmp(d.type, "TV") ? ICON_TV_FILL : ICON_DEVICES_FILL;
    spr.fillSmoothRoundRect(x0, cy - ts / 2, ts, ts, 8, d.active ? mix(C_GREEN, C_CARD, 0.22f) : C_CARD);
    text(x0 + ts / 2, cy, icon, I_M, d.active ? C_GREEN : C_MUTED, middle_center);
    textFit(x0 + ts + 24, cy - 16, d.name, W - x0 - ts - 24 - 160, F_BIG, d.active ? C_GREEN : C_TEXT, middle_left);
    char buf[48];
    snprintf(buf, sizeof buf, d.volume >= 0 ? "%s%s  /  volume %d%%" : "%s%s", d.active ? "Playing  /  " : "", d.type, d.volume);
    text(x0 + ts + 24, cy + 20, buf, F_STAT, C_DIM, middle_left);
    if (!d.active) {
      text(W - 56, cy, ICON_PLAY_ARROW_FILL, I_M, C_MUTED, middle_center);
      hit(0, y, W, rh, ACT_SPOTIFY, SPU_DEVICE + i);  // tap: play here
    }
  }
}

static void drawSpotify(const Status& s, const tm* clock) {
  if (spSheet == SPU_LIBRARY) { drawSpotifyLibrary(s); return; }
  if (spSheet == SPU_DEVICES) { drawSpotifyDevices(s); return; }
  // Background: the tint darkened (its brightest channel at ~82 of 255, so white text keeps its contrast), fading
  // darker toward the bottom; scaled by the palette, so night mode dims it too.
  uint32_t top, bottom;
  {
    int r = spTint >> 16 & 255, g = spTint >> 8 & 255, b = spTint & 255, mx = std::max({r, g, b, 1});
    float k = std::min(1.0f, 82.0f / mx) * palK;
    top = uint32_t(r * k) << 16 | uint32_t(g * k) << 8 | uint32_t(b * k);
    bottom = mix(top, 0x000000, 0.35f);
  }
  auto bgAt = [&](int y) { return mix(top, bottom, 1 - float(y) / H); };
  static Gradient bg;  // dithered and cached per album: a plain gradient this dark bands visibly
  gradient(bg, top, bottom, 1.0f);

  // Art with a soft shadow, rounded at the corners.
  const int A = SPOTIFY_ART;
  const uint32_t shadow = mix(bgAt(SP_ART_Y + A), 0x000000, 0.4f);
  spr.fillSmoothRoundRect(SP_ART_X - 2, SP_ART_Y + 6, A + 4, A + 6, 14, mix(bgAt(SP_ART_Y + A), 0x000000, 0.7f));
  spr.fillSmoothRoundRect(SP_ART_X, SP_ART_Y + 3, A, A + 2, 12, shadow);
  if (spArtHave && sp.active) spArt.pushSprite(&spr, SP_ART_X, SP_ART_Y);
  else {
    spr.fillRect(SP_ART_X, SP_ART_Y, A, A, mix(0xFFFFFF, top, 0.08f));
    text(SP_ART_X + A / 2, SP_ART_Y + A / 2, ICON_MUSIC_NOTE, I_L, mix(C_TEXT, top, 0.35f), middle_center);
  }
  roundCorners(SP_ART_X, SP_ART_Y, A, A, 10, bgAt(SP_ART_Y), shadow);

  // Text, centred on the art's height: album (faded), title (huge, up to two lines), artist, then where it plays
  // (or why it can't: amber).
  const bool setUp = spSetUp(), track = setUp && sp.active;
  const int tx = SP_ART_X + A + 44, tw = W - 40 - tx;
  const char* title = !setUp ? "Not set up yet" : sp.active ? sp.title : "Nothing playing";
  spr.setFont(F_HUGE);
  const int lines = spr.textWidth(title) > tw ? 2 : 1;
  char status[96];
  uint32_t statusCol = mix(C_TEXT, top, 0.55f);
  if (!setUp) snprintf(status, sizeof status, "Add the SPOTIFY_ values to config.h: see the README");
  else if (*sp.error) { snprintf(status, sizeof status, "%s", sp.error); statusCol = C_AMBER; }
  else if (!s.wifi) { snprintf(status, sizeof status, "Waiting for Wi-Fi..."); statusCol = C_AMBER; }
  else if (!s.spotify) snprintf(status, sizeof status, "Connecting to Spotify...");
  else if (sp.active) snprintf(status, sizeof status, "%s on %s", sp.playing ? "Playing" : "Paused", sp.device);
  else snprintf(status, sizeof status, "Play something from your library, or on one of your devices");
  int y = SP_ART_Y + (A - ((track ? 38 : 0) + lines * 58 + (track ? 40 : 0) + 34)) / 2;
  if (track) { textFit(tx, y, sp.album, tw, F_TITLE, mix(C_TEXT, top, 0.7f)); y += 38; }
  y = wrapText(tx, y, tw, y + lines * 58, title, F_HUGE, C_TEXT, 58, 0);
  if (track) { textFit(tx, y + 4, sp.artist, tw, F_STAT, mix(C_TEXT, top, 0.9f)); y += 40; }
  textFit(tx, y + 10, status, tw, F_BODY, statusCol);
  if (!track) {  // start something: the library, or a device to play on
    spVolume = false;
    if (setUp) {
      const struct { const char* icon; const char* label; uint8_t op; } btn[2] = {
          {ICON_LIBRARY_MUSIC_FILL, "Library", SPU_LIBRARY}, {ICON_SPEAKER_GROUP_FILL, "Devices", SPU_DEVICES}};
      for (int i = 0; i < 2; i++) {
        const int bx = tx + i * 196, by = SP_ART_Y + A - 64, bw = 180, bh = 60;
        spr.fillSmoothRoundRect(bx, by, bw, bh, bh / 2, mix(C_TEXT, top, 0.16f));
        text(bx + 38, by + bh / 2, btn[i].icon, I_M, C_TEXT, middle_center);
        text(bx + 66, by + bh / 2, btn[i].label, F_BODYB, C_TEXT, middle_left);
        hit(bx, by, bw, bh, ACT_SPOTIFY, btn[i].op);
      }
    }
    spFlash = -1;
    return;
  }

  // Progress: a thin full-width bar (tap or drag to seek), the times just above its ends.
  char buf[24];
  const uint32_t white = C_TEXT, faded = mix(C_TEXT, top, 0.55f);
  fmtMs(buf, sizeof buf, sp.progressMs);
  text(16, SP_BAR_Y - 8, buf, F_SMALL, faded, bottom_left);
  fmtMs(buf, sizeof buf, sp.durationMs);
  text(W - 16, SP_BAR_Y - 8, buf, F_SMALL, faded, bottom_right);
  const float f = sp.durationMs ? clampf(float(sp.progressMs) / sp.durationMs, 0, 1) : 0;
  spr.fillRect(0, SP_BAR_Y - 2, W, 5, mix(white, bottom, 0.22f));
  spr.fillRect(0, SP_BAR_Y - 2, int(W * f), 5, white);
  hit(-12, SP_BAR_Y - 30, W + 24, 38, ACT_SPOTIFY, SP_SEEK);  // 12 px to spare each side, as uiTap expects

  // The strip: seven big buttons, or the volume slider.
  spr.fillRect(0, SP_STRIP_Y, W, H - SP_STRIP_Y, mix(bottom, 0x000000, 0.4f));
  const int sy = SP_STRIP_Y + (H - SP_STRIP_Y) / 2;
  if (spVolume) {
    text(70, sy, ICON_VOLUME_UP_FILL, I_M, white, middle_center);
    const int vx = 130, vw = W - 130 - 260, v = std::max(sp.volume, 0);
    spr.fillSmoothRoundRect(vx, sy - 4, vw, 8, 4, mix(white, bottom, 0.22f));
    spr.fillSmoothRoundRect(vx, sy - 4, std::max(8, vw * v / 100), 8, 4, white);
    spr.fillSmoothCircle(vx + vw * v / 100, sy, 13, white);
    hit(vx - 12, SP_STRIP_Y, vw + 24, H - SP_STRIP_Y, ACT_SPOTIFY, SP_VOLUME);
    snprintf(buf, sizeof buf, "%d%%", v);
    text(W - 150, sy, buf, F_STAT, white, middle_right);
    text(W - 70, sy, ICON_CLOSE, I_M, white, middle_center);
    hit(W - 140, SP_STRIP_Y, 140, H - SP_STRIP_Y, ACT_SPOTIFY, SPU_VOLUME_CLOSE);
    spFlash = -1;
    return;
  }
  const struct { const char* icon; uint8_t cmd; bool on, dim; } b[9] = {
      {ICON_LIBRARY_MUSIC_FILL, SPU_LIBRARY, false, false},
      {sp.liked ? ICON_FAVORITE_FILL : ICON_FAVORITE, SP_LIKE, sp.liked, !*sp.id},
      {ICON_SHUFFLE, SP_SHUFFLE, sp.shuffle, false},
      {ICON_SKIP_PREVIOUS_FILL, SP_PREV, false, false},
      {sp.playing ? ICON_PAUSE_FILL : ICON_PLAY_ARROW_FILL, SP_PLAY, false, false},
      {ICON_SKIP_NEXT_FILL, SP_NEXT, false, false},
      {sp.repeat == 2 ? ICON_REPEAT_ONE : ICON_REPEAT, SP_REPEAT, sp.repeat > 0, false},
      {ICON_VOLUME_UP_FILL, SPU_VOLUME_OPEN, false, !sp.canVolume || sp.volume < 0},  // most phones: fixed
      {ICON_SPEAKER_GROUP_FILL, SPU_DEVICES, false, false}};
  for (int i = 0; i < 9; i++) {
    const int cx = W * (2 * i + 1) / 18;
    if (spFlash == b[i].cmd || (b[i].cmd == SP_PLAY && spFlash == SP_PAUSE))
      spr.fillSmoothCircle(cx, sy, 38, mix(white, bottom, 0.2f));
    text(cx, sy, b[i].icon, I_M, b[i].dim ? mix(white, bottom, 0.35f) : b[i].on ? C_GREEN : white, middle_center);
    if (b[i].on && b[i].cmd != SP_LIKE) dot(cx, sy + 30, C_GREEN);
    if (!b[i].dim) hit(cx - W / 18, SP_STRIP_Y, W / 9, H - SP_STRIP_Y, ACT_SPOTIFY, b[i].cmd);
  }
  spFlash = -1;
}

// Home screen (swipe up from anywhere): a big clock, then a tile per app with live lines: two wide tiles over three.
static void drawLauncher(const Data& d, const Status& s, const tm* t) {
  background(C_BLUE);
  gear(W - 34, 30, C_MUTED);
  hit(W - 80, 0, 80, 64, ACT_SETTINGS, 0);
  if (t) {
    char buf[32];
    const char* ampm = fmtClock(buf, sizeof buf, t);
    spr.setFont(F_XL);
    const int tw = spr.textWidth(buf);
    spr.setFont(F_TITLE);
    const int aw = ampm ? spr.textWidth(ampm) + 12 : 0, x0 = (W - tw - aw) / 2;
    text(x0, 146, buf, F_XL, C_TEXT, baseline_left);
    if (ampm) text(x0 + tw + 12, 146, ampm, F_TITLE, C_MUTED, baseline_left);
    strftime(buf, sizeof buf, "%A, %B %d", t);
    text(W / 2, 184, buf, F_STAT, C_MUTED, middle_center);
  }
  const bool spOn = spSetUp();
  const int th = 150;
  for (int i = 0; i < 5; i++) {
    const int row = i >= 2, cols = row ? 3 : 2, tw = (BODY_W - (cols - 1) * GAP) / cols;
    const int x = M + (row ? i - 2 : i) * (tw + GAP), y = 228 + row * (th + GAP), tx = x + 120, cy = y + th / 2;
    static const uint8_t ids[5] = {FN_STATS, FN_RADAR, FN_SPOTIFY, FN_MACRO, FN_DECK};
    const uint8_t id = ids[i];
    card(x, y, tw, th);
    hit(x, y, tw, th, ACT_APP, id);
    // The icon in a soft circle of its colour (Spotify: the album art, once there is some).
    struct { const char* icon; uint32_t col; const char* name; } a[] = {
        {ICON_DNS_FILL, C_CYAN, "Server Stats"}, {ICON_RADAR, C_GREEN, "Weather Radar"},
        {ICON_MUSIC_NOTE, C_VIOLET, "Spotify"}, {ICON_KEYBOARD_FILL, C_PINK, "Macro Pad"},
        {ICON_GRID_VIEW_FILL, C_TEAL, "Stream Deck"}};
    if (id == FN_SPOTIFY && spThumbHave && sp.active) {
      spThumb.pushSprite(&spr, x + 24, cy - 36);
      roundCorners(x + 24, cy - 36, 72, 72, 12, C_CARD);
    } else {
      spr.fillSmoothCircle(x + 60, cy, 36, mix(a[i].col, C_CARD, 0.18f));
      text(x + 60, cy, a[i].icon, I_M, a[i].col, middle_center);
    }
    text(tx, y + 30, a[i].name, F_TITLE, C_TEXT);
    const int lw = x + tw - 24 - tx;
    char buf[64];
    auto line = [&](int ly, uint32_t dotCol, const char* s, uint32_t ink = 0) {
      if (dotCol) dot(tx + 4, ly, dotCol);
      textFit(tx + (dotCol ? 16 : 0), ly, s, lw - (dotCol ? 16 : 0), F_BODY, ink ? ink : C_MUTED, middle_left);
    };
    switch (id) {
      case FN_STATS:
        for (int k = 0; k < 2; k++) {
          const bool ok = k ? s.nas : s.pc;
          const int ly = y + 88 + k * 30;
          line(ly, ok ? C_GREEN : C_RED, k ? NAS_NAME : PC_NAME);
          const float cpu = k ? d.nasCpu : d.pcCpu, gpu = k ? d.nasGpu : d.pcGpu;
          if (ok && !isnan(cpu) && !isnan(gpu)) {  // live load, so the tile is worth a glance on its own
            snprintf(buf, sizeof buf, "CPU %.0f%%   GPU %.0f%%", cpu, gpu);
            text(x + tw - 24, ly, buf, F_BODY, C_TEXT, middle_right);
          }
        }
        break;
      case FN_RADAR:
        text(tx + 10, y + 88, ICON_LOCATION_ON_FILL, I_S, C_GREEN, middle_center);
        textFit(tx + 28, y + 88, settings.radarPlace, lw - 28, F_BODY, C_MUTED, middle_left);
        if (wx && wx->have && !isnan(wx->tempF)) {  // the last weather the radar fetched
          uint32_t ic;
          const char* icon = wxIcon(wx->sky, t && (t->tm_hour < 6 || t->tm_hour >= 19), ic);
          text(tx + 10, y + 118, icon, I_S, ic, middle_center);
          snprintf(buf, sizeof buf, "%.0f" DEG "  %s", wx->tempF, wx->sky);
          textFit(tx + 28, y + 118, buf, lw - 28, F_BODY, C_TEXT, middle_left);
        }
        break;
      case FN_SPOTIFY:
        if (!spOn) line(y + 88, C_RED, "Not set up: see the README");
        else if (sp.active) {
          textFit(tx, y + 86, sp.title, lw, F_BODY, C_TEXT, middle_left);
          snprintf(buf, sizeof buf, "%s  /  %s", sp.artist, sp.device);
          textFit(tx, y + 112, buf, lw, F_SMALL, C_MUTED, middle_left);
        } else line(y + 88, *sp.error ? C_RED : C_DIM, *sp.error ? "Not connected" : "Nothing playing");
        break;
      case FN_MACRO: line(y + 88, s.usb ? C_GREEN : C_RED, s.usb ? "USB connected" : "USB not connected"); break;
      default: line(y + 88, s.deck ? C_GREEN : C_RED, s.deck ? "Companion connected" : "Companion not connected");
    }
  }
  text(W / 2, H - 18, "Swipe up from any screen to come back here", F_SMALL, C_DIM, middle_center);
}

void uiDraw(const Data& d, const Status& s, const tm* clock, bool night, const SysInfo& sys) {
  ensureFonts();
  // The palette is drawn as designed by day; night mode dims it by THEME_NIGHT relative to THEME_DAY. Every screen
  // paints its whole background each frame (each frame goes to the other of the two frame buffers anyway).
  static int lastNight = -1;
  if (night != lastNight) { lastNight = night; setPalette(night ? THEME_NIGHT / THEME_DAY : 1.0f); }
  nHits = 0;
  for (int i = 0; i < 5; i++) {
    char age[24];
    fmtAge(age, sizeof age, sys.ageS[i]);
    snprintf(offTxt[i], sizeof offTxt[i], sys.ageS[i] == UINT32_MAX ? "OFFLINE  /  never connected" : "OFFLINE  /  last seen %s", age);
  }

  if (detail == DET_SETTINGS) { drawSettings(s, clock, sys); return; }
  if (home) { drawLauncher(d, s, clock); return; }
  if (app == FN_MACRO) { drawMacroPad(s, clock); return; }
  if (app == FN_DECK) { drawDeck(s, clock); return; }
  if (app == FN_SPOTIFY) { drawSpotify(s, clock); return; }
  if (app == FN_RADAR) {
    if (radarSheet) drawRadarSheet(s, clock);
    else if (radarAlert >= 0) drawRadarAlert(s, clock);
    else drawRadarMap(s, clock);
    return;
  }
  if (detail == DET_CAMERA) { drawCameraView(d, s, clock); return; }
  if (detail != DET_NONE) {
    if (drawDetail(s, clock)) return;
    detail = DET_NONE;  // its subject vanished: fall back to the page
    nHits = 0;
  }
  background(C_CYAN);
  char sub[64];
  switch (page) {
    case PAGE_PC:
      statusBar(clock, s.wifi, ICON_DESKTOP_WINDOWS_FILL, C_CYAN, PC_NAME, PC_SUB, 0, s.pc, offTxt[0], false, true);
      drawPcPage(d, s.pc);
      break;
    case PAGE_NAS:
      statusBar(clock, s.wifi, ICON_DNS_FILL, C_CYAN, NAS_NAME, NAS_SUB, 0, s.nas, offTxt[1], false, true);
      drawNasPage(d, s.nas, s.unraid);
      break;
    case PAGE_STORAGE:
      statusBar(clock, s.wifi, ICON_HARD_DRIVE_FILL, C_CYAN, "Storage", NAS_NAME " array", 0, s.unraid, offTxt[2], false, true);
      drawStoragePage(d, s.unraid);
      break;
    case PAGE_PRINTER: {
      uint32_t col = C_DIM;
      const char* st = !*PRINTER_IP ? "Not set up" : prState(d.pr, col);
      statusBar(clock, s.wifi, ICON_PRINT_FILL, C_CYAN, PRINTER_NAME, st, col, s.printer, offTxt[4], false, true);
      drawPrinterPage(d, s, clock);
      break;
    }
    default: {
      int running = 0;
      for (int i = 0; i < d.nCtr; i++) running += statusColor(d.ctr[i].status) == C_GREEN;
      snprintf(sub, sizeof sub, "%d of %d running  /  " NAS_NAME, running, d.nCtr);
      statusBar(clock, s.wifi, ICON_DEPLOYED_CODE_FILL, C_CYAN, "Containers", sub, C_GREEN, s.docker, offTxt[3], false, true);
      drawDockerPage(d, s.docker);
    }
  }
  tabStrip(page);
}
